CM_ "AUTOGENERATED FILE, DO NOT EDIT";

CM_ "hyundai_canfd_radar.dbc starts here";

VERSION ""

NS_ :

BS_:

BU_: XXX

BO_ 528 RADAR_TRACK_210: 32 RADAR
 SG_ NEW_SIGNAL_25 : 26|3@0+ (1,0) [0|7] "" XXX
 SG_ NEW_SIGNAL_24 : 28|2@0+ (1,0) [0|3] "" XXX
 SG_ NEW_SIGNAL_21 : 36|5@0+ (1,0) [0|31] "" XXX
 SG_ NEW_SIGNAL_20 : 39|3@0+ (1,0) [0|7] "" XXX
 SG_ VALID_CNT1 : 47|8@0+ (1,0) [0|255] "" XXX
 SG_ NEW_SIGNAL_15 : 51|4@0+ (1,0) [0|15] "" XXX
 SG_ NEW_SIGNAL_14 : 55|4@0+ (1,0) [0|15] "" XXX
 SG_ NEW_SIGNAL_5 : 63|8@0- (1,0) [0|255] "" XXX
 SG_ LONG_DIST1 : 64|12@1+ (0.05,0) [0|4095] "" XXX
 SG_ LAT_DIST1 : 76|12@1- (0.05,0) [0|4095] "" XXX
 SG_ REL_SPEED1 : 88|14@1- (0.01,0) [0|16383] "" XXX
 SG_ NEW_SIGNAL_16 : 103|2@0+ (1,0) [0|3] "" XXX
 SG_ LAT_SPEED1 : 104|13@1- (0.01,0) [0|8191] "" XXX
 SG_ REL_ACCEL1 : 118|10@1- (0.05,0) [0|1023] "" XXX
 SG_ NEW_SIGNAL_27 : 154|3@0+ (1,0) [0|7] "" XXX
 SG_ NEW_SIGNAL_26 : 156|2@0+ (1,0) [0|3] "" XXX
 SG_ NEW_SIGNAL_23 : 164|5@0+ (1,0) [0|31] "" XXX
 SG_ NEW_SIGNAL_22 : 167|3@0+ (1,0) [0|7] "" XXX
 SG_ VALID_CNT2 : 175|8@0+ (1,0) [0|255] "" XXX
 SG_ NEW_SIGNAL_13 : 179|4@0+ (1,0) [0|15] "" XXX
 SG_ NEW_SIGNAL_12 : 183|4@0+ (1,0) [0|15] "" XXX
 SG_ NEW_SIGNAL_11 : 191|8@0- (1,0) [0|255] "" XXX
 SG_ LONG_DIST2 : 192|12@1+ (0.05,0) [0|4095] "" XXX
 SG_ LAT_DIST2 : 204|12@1- (0.05,0) [0|4095] "" XXX
 SG_ REL_SPEED2 : 216|14@1- (0.01,0) [0|16383] "" XXX
 SG_ NEW_SIGNAL_17 : 231|2@0+ (1,0) [0|3] "" XXX
 SG_ LAT_SPEED2 : 232|13@1- (0.01,0) [0|8191] "" XXX
 SG_ REL_ACCEL2 : 246|10@1- (0.05,0) [0|1023] "" XXX

BO_ 529 RADAR_TRACK_211: 32 RADAR
 SG_ NEW_SIGNAL_25 : 26|3@0+ (1,0) [0|7] "" XXX
 SG_ NEW_SIGNAL_24 : 28|2@0+ (1,0) [0|3] "" XXX
 SG_ NEW_SIGNAL_21 : 36|5@0+ (1,0) [0|31] "" XXX
 SG_ NEW_SIGNAL_20 : 39|3@0+ (1,0) [0|7] "" XXX
 SG_ VALID_CNT1 : 47|8@0+ (1,0) [0|255] "" XXX
 SG_ NEW_SIGNAL_15 : 51|4@0+ (1,0) [0|15] "" XXX
 SG_ NEW_SIGNAL_14 : 55|4@0+ (1,0) [0|15] "" XXX
 SG_ NEW_SIGNAL_5 : 63|8@0- (1,0) [0|255] "" XXX
 SG_ LONG_DIST1 : 64|12@1+ (0.05,0) [0|4095] "" XXX
 SG_ LAT_DIST1 : 76|12@1- (0.05,0) [0|4095] "" XXX
 SG_ REL_SPEED1 : 88|14@1- (0.01,0) [0|16383] "" XXX
 SG_ NEW_SIGNAL_16 : 103|2@0+ (1,0) [0|3] "" XXX
 SG_ LAT_SPEED1 : 104|13@1- (0.01,0) [0|8191] "" XXX
 SG_ REL_ACCEL1 : 118|10@1- (0.05,0) [0|1023] "" XXX
 SG_ NEW_SIGNAL_27 : 154|3@0+ (1,0) [0|7] "" XXX
 SG_ NEW_SIGNAL_26 : 156|2@0+ (1,0) [0|3] "" XXX
 SG_ NEW_SIGNAL_23 : 164|5@0+ (1,0) [0|31] "" XXX
 SG_ NEW_SIGNAL_22 : 167|3@0+ (1,0) [0|7] "" XXX
 SG_ VALID_CNT2 : 175|8@0+ (1,0) [0|255] "" XXX
 SG_ NEW_SIGNAL_13 : 179|4@0+ (1,0) [0|15] "" XXX
 SG_ NEW_SIGNAL_12 : 183|4@0+ (1,0) [0|15] "" XXX
 SG_ NEW_SIGNAL_11 : 191|8@0- (1,0) [0|255] "" XXX
 SG_ LONG_DIST2 : 192|12@1+ (0.05,0) [0|4095] "" XXX
 SG_ LAT_DIST2 : 204|12@1- (0.05,0) [0|4095] "" XXX
 SG_ REL_SPEED2 : 216|14@1- (0.01,0) [0|16383] "" XXX
 SG_ NEW_SIGNAL_17 : 231|2@0+ (1,0) [0|3] "" XXX
 SG_ LAT_SPEED2 : 232|13@1- (0.01,0) [0|8191] "" XXX
 SG_ REL_ACCEL2 : 246|10@1- (0.05,0) [0|1023] "" XXX

BO_ 530 RADAR_TRACK_212: 32 RADAR
 SG_ NEW_SIGNAL_25 : 26|3@0+ (1,0) [0|7] "" XXX
 SG_ NEW_SIGNAL_24 : 28|2@0+ (1,0) [0|3] "" XXX
 SG_ NEW_SIGNAL_21 : 36|5@0+ (1,0) [0|31] "" XXX
 SG_ NEW_SIGNAL_20 : 39|3@0+ (1,0) [0|7] "" XXX
 SG_ VALID_CNT1 : 47|8@0+ (1,0) [0|255] "" XXX
 SG_ NEW_SIGNAL_15 : 51|4@0+ (1,0) [0|15] "" XXX
 SG_ NEW_SIGNAL_14 : 55|4@0+ (1,0) [0|15] "" XXX
 SG_ NEW_SIGNAL_5 : 63|8@0- (1,0) [0|255] "" XXX
 SG_ LONG_DIST1 : 64|12@1+ (0.05,0) [0|4095] "" XXX
 SG_ LAT_DIST1 : 76|12@1- (0.05,0) [0|4095] "" XXX
 SG_ REL_SPEED1 : 88|14@1- (0.01,0) [0|16383] "" XXX
 SG_ NEW_SIGNAL_16 : 103|2@0+ (1,0) [0|3] "" XXX
 SG_ LAT_SPEED1 : 104|13@1- (0.01,0) [0|8191] "" XXX
 SG_ REL_ACCEL1 : 118|10@1- (0.05,0) [0|1023] "" XXX
 SG_ NEW_SIGNAL_27 : 154|3@0+ (1,0) [0|7] "" XXX
 SG_ NEW_SIGNAL_26 : 156|2@0+ (1,0) [0|3] "" XXX
 SG_ NEW_SIGNAL_23 : 164|5@0+ (1,0) [0|31] "" XXX
 SG_ NEW_SIGNAL_22 : 167|3@0+ (1,0) [0|7] "" XXX
 SG_ VALID_CNT2 : 175|8@0+ (1,0) [0|255] "" XXX
 SG_ NEW_SIGNAL_13 : 179|4@0+ (1,0) [0|15] "" XXX
 SG_ NEW_SIGNAL_12 : 183|4@0+ (1,0) [0|15] "" XXX
 SG_ NEW_SIGNAL_11 : 191|8@0- (1,0) [0|255] "" XXX
 SG_ LONG_DIST2 : 192|12@1+ (0.05,0) [0|4095] "" XXX
 SG_ LAT_DIST2 : 204|12@1- (0.05,0) [0|4095] "" XXX
 SG_ REL_SPEED2 : 216|14@1- (0.01,0) [0|16383] "" XXX
 SG_ NEW_SIGNAL_17 : 231|2@0+ (1,0) [0|3] "" XXX
 SG_ LAT_SPEED2 : 232|13@1- (0.01,0) [0|8191] "" XXX
 SG_ REL_ACCEL2 : 246|10@1- (0.05,0) [0|1023] "" XXX

BO_ 531 RADAR_TRACK_213: 32 RADAR
 SG_ NEW_SIGNAL_25 : 26|3@0+ (1,0) [0|7] "" XXX
 SG_ NEW_SIGNAL_24 : 28|2@0+ (1,0) [0|3] "" XXX
 SG_ NEW_SIGNAL_21 : 36|5@0+ (1,0) [0|31] "" XXX
 SG_ NEW_SIGNAL_20 : 39|3@0+ (1,0) [0|7] "" XXX
 SG_ VALID_CNT1 : 47|8@0+ (1,0) [0|255] "" XXX
 SG_ NEW_SIGNAL_15 : 51|4@0+ (1,0) [0|15] "" XXX
 SG_ NEW_SIGNAL_14 : 55|4@0+ (1,0) [0|15] "" XXX
 SG_ NEW_SIGNAL_5 : 63|8@0- (1,0) [0|255] "" XXX
 SG_ LONG_DIST1 : 64|12@1+ (0.05,0) [0|4095] "" XXX
 SG_ LAT_DIST1 : 76|12@1- (0.05,0) [0|4095] "" XXX
 SG_ REL_SPEED1 : 88|14@1- (0.01,0) [0|16383] "" XXX
 SG_ NEW_SIGNAL_16 : 103|2@0+ (1,0) [0|3] "" XXX
 SG_ LAT_SPEED1 : 104|13@1- (0.01,0) [0|8191] "" XXX
 SG_ REL_ACCEL1 : 118|10@1- (0.05,0) [0|1023] "" XXX
 SG_ NEW_SIGNAL_27 : 154|3@0+ (1,0) [0|7] "" XXX
 SG_ NEW_SIGNAL_26 : 156|2@0+ (1,0) [0|3] "" XXX
 SG_ NEW_SIGNAL_23 : 164|5@0+ (1,0) [0|31] "" XXX
 SG_ NEW_SIGNAL_22 : 167|3@0+ (1,0) [0|7] "" XXX
 SG_ VALID_CNT2 : 175|8@0+ (1,0) [0|255] "" XXX
 SG_ NEW_SIGNAL_13 : 179|4@0+ (1,0) [0|15] "" XXX
 SG_ NEW_SIGNAL_12 : 183|4@0+ (1,0) [0|15] "" XXX
 SG_ NEW_SIGNAL_11 : 191|8@0- (1,0) [0|255] "" XXX
 SG_ LONG_DIST2 : 192|12@1+ (0.05,0) [0|4095] "" XXX
 SG_ LAT_DIST2 : 204|12@1- (0.05,0) [0|4095] "" XXX
 SG_ REL_SPEED2 : 216|14@1- (0.01,0) [0|16383] "" XXX
 SG_ NEW_SIGNAL_17 : 231|2@0+ (1,0) [0|3] "" XXX
 SG_ LAT_SPEED2 : 232|13@1- (0.01,0) [0|8191] "" XXX
 SG_ REL_ACCEL2 : 246|10@1- (0.05,0) [0|1023] "" XXX

BO_ 532 RADAR_TRACK_214: 32 RADAR
 SG_ NEW_SIGNAL_25 : 26|3@0+ (1,0) [0|7] "" XXX
 SG_ NEW_SIGNAL_24 : 28|2@0+ (1,0) [0|3] "" XXX
 SG_ NEW_SIGNAL_21 : 36|5@0+ (1,0) [0|31] "" XXX
 SG_ NEW_SIGNAL_20 : 39|3@0+ (1,0) [0|7] "" XXX
 SG_ VALID_CNT1 : 47|8@0+ (1,0) [0|255] "" XXX
 SG_ NEW_SIGNAL_15 : 51|4@0+ (1,0) [0|15] "" XXX
 SG_ NEW_SIGNAL_14 : 55|4@0+ (1,0) [0|15] "" XXX
 SG_ NEW_SIGNAL_5 : 63|8@0- (1,0) [0|255] "" XXX
 SG_ LONG_DIST1 : 64|12@1+ (0.05,0) [0|4095] "" XXX
 SG_ LAT_DIST1 : 76|12@1- (0.05,0) [0|4095] "" XXX
 SG_ REL_SPEED1 : 88|14@1- (0.01,0) [0|16383] "" XXX
 SG_ NEW_SIGNAL_16 : 103|2@0+ (1,0) [0|3] "" XXX
 SG_ LAT_SPEED1 : 104|13@1- (0.01,0) [0|8191] "" XXX
 SG_ REL_ACCEL1 : 118|10@1- (0.05,0) [0|1023] "" XXX
 SG_ NEW_SIGNAL_27 : 154|3@0+ (1,0) [0|7] "" XXX
 SG_ NEW_SIGNAL_26 : 156|2@0+ (1,0) [0|3] "" XXX
 SG_ NEW_SIGNAL_23 : 164|5@0+ (1,0) [0|31] "" XXX
 SG_ NEW_SIGNAL_22 : 167|3@0+ (1,0) [0|7] "" XXX
 SG_ VALID_CNT2 : 175|8@0+ (1,0) [0|255] "" XXX
 SG_ NEW_SIGNAL_13 : 179|4@0+ (1,0) [0|15] "" XXX
 SG_ NEW_SIGNAL_12 : 183|4@0+ (1,0) [0|15] "" XXX
 SG_ NEW_SIGNAL_11 : 191|8@0- (1,0) [0|255] "" XXX
 SG_ LONG_DIST2 : 192|12@1+ (0.05,0) [0|4095] "" XXX
 SG_ LAT_DIST2 : 204|12@1- (0.05,0) [0|4095] "" XXX
 SG_ REL_SPEED2 : 216|14@1- (0.01,0) [0|16383] "" XXX
 SG_ NEW_SIGNAL_17 : 231|2@0+ (1,0) [0|3] "" XXX
 SG_ LAT_SPEED2 : 232|13@1- (0.01,0) [0|8191] "" XXX
 SG_ REL_ACCEL2 : 246|10@1- (0.05,0) [0|1023] "" XXX

BO_ 533 RADAR_TRACK_215: 32 RADAR
 SG_ NEW_SIGNAL_25 : 26|3@0+ (1,0) [0|7] "" XXX
 SG_ NEW_SIGNAL_24 : 28|2@0+ (1,0) [0|3] "" XXX
 SG_ NEW_SIGNAL_21 : 36|5@0+ (1,0) [0|31] "" XXX
 SG_ NEW_SIGNAL_20 : 39|3@0+ (1,0) [0|7] "" XXX
 SG_ VALID_CNT1 : 47|8@0+ (1,0) [0|255] "" XXX
 SG_ NEW_SIGNAL_15 : 51|4@0+ (1,0) [0|15] "" XXX
 SG_ NEW_SIGNAL_14 : 55|4@0+ (1,0) [0|15] "" XXX
 SG_ NEW_SIGNAL_5 : 63|8@0- (1,0) [0|255] "" XXX
 SG_ LONG_DIST1 : 64|12@1+ (0.05,0) [0|4095] "" XXX
 SG_ LAT_DIST1 : 76|12@1- (0.05,0) [0|4095] "" XXX
 SG_ REL_SPEED1 : 88|14@1- (0.01,0) [0|16383] "" XXX
 SG_ NEW_SIGNAL_16 : 103|2@0+ (1,0) [0|3] "" XXX
 SG_ LAT_SPEED1 : 104|13@1- (0.01,0) [0|8191] "" XXX
 SG_ REL_ACCEL1 : 118|10@1- (0.05,0) [0|1023] "" XXX
 SG_ NEW_SIGNAL_27 : 154|3@0+ (1,0) [0|7] "" XXX
 SG_ NEW_SIGNAL_26 : 156|2@0+ (1,0) [0|3] "" XXX
 SG_ NEW_SIGNAL_23 : 164|5@0+ (1,0) [0|31] "" XXX
 SG_ NEW_SIGNAL_22 : 167|3@0+ (1,0) [0|7] "" XXX
 SG_ VALID_CNT2 : 175|8@0+ (1,0) [0|255] "" XXX
 SG_ NEW_SIGNAL_13 : 179|4@0+ (1,0) [0|15] "" XXX
 SG_ NEW_SIGNAL_12 : 183|4@0+ (1,0) [0|15] "" XXX
 SG_ NEW_SIGNAL_11 : 191|8@0- (1,0) [0|255] "" XXX
 SG_ LONG_DIST2 : 192|12@1+ (0.05,0) [0|4095] "" XXX
 SG_ LAT_DIST2 : 204|12@1- (0.05,0) [0|4095] "" XXX
 SG_ REL_SPEED2 : 216|14@1- (0.01,0) [0|16383] "" XXX
 SG_ NEW_SIGNAL_17 : 231|2@0+ (1,0) [0|3] "" XXX
 SG_ LAT_SPEED2 : 232|13@1- (0.01,0) [0|8191] "" XXX
 SG_ REL_ACCEL2 : 246|10@1- (0.05,0) [0|1023] "" XXX

BO_ 534 RADAR_TRACK_216: 32 RADAR
 SG_ NEW_SIGNAL_25 : 26|3@0+ (1,0) [0|7] "" XXX
 SG_ NEW_SIGNAL_24 : 28|2@0+ (1,0) [0|3] "" XXX
 SG_ NEW_SIGNAL_21 : 36|5@0+ (1,0) [0|31] "" XXX
 SG_ NEW_SIGNAL_20 : 39|3@0+ (1,0) [0|7] "" XXX
 SG_ VALID_CNT1 : 47|8@0+ (1,0) [0|255] "" XXX
 SG_ NEW_SIGNAL_15 : 51|4@0+ (1,0) [0|15] "" XXX
 SG_ NEW_SIGNAL_14 : 55|4@0+ (1,0) [0|15] "" XXX
 SG_ NEW_SIGNAL_5 : 63|8@0- (1,0) [0|255] "" XXX
 SG_ LONG_DIST1 : 64|12@1+ (0.05,0) [0|4095] "" XXX
 SG_ LAT_DIST1 : 76|12@1- (0.05,0) [0|4095] "" XXX
 SG_ REL_SPEED1 : 88|14@1- (0.01,0) [0|16383] "" XXX
 SG_ NEW_SIGNAL_16 : 103|2@0+ (1,0) [0|3] "" XXX
 SG_ LAT_SPEED1 : 104|13@1- (0.01,0) [0|8191] "" XXX
 SG_ REL_ACCEL1 : 118|10@1- (0.05,0) [0|1023] "" XXX
 SG_ NEW_SIGNAL_27 : 154|3@0+ (1,0) [0|7] "" XXX
 SG_ NEW_SIGNAL_26 : 156|2@0+ (1,0) [0|3] "" XXX
 SG_ NEW_SIGNAL_23 : 164|5@0+ (1,0) [0|31] "" XXX
 SG_ NEW_SIGNAL_22 : 167|3@0+ (1,0) [0|7] "" XXX
 SG_ VALID_CNT2 : 175|8@0+ (1,0) [0|255] "" XXX
 SG_ NEW_SIGNAL_13 : 179|4@0+ (1,0) [0|15] "" XXX
 SG_ NEW_SIGNAL_12 : 183|4@0+ (1,0) [0|15] "" XXX
 SG_ NEW_SIGNAL_11 : 191|8@0- (1,0) [0|255] "" XXX
 SG_ LONG_DIST2 : 192|12@1+ (0.05,0) [0|4095] "" XXX
 SG_ LAT_DIST2 : 204|12@1- (0.05,0) [0|4095] "" XXX
 SG_ REL_SPEED2 : 216|14@1- (0.01,0) [0|16383] "" XXX
 SG_ NEW_SIGNAL_17 : 231|2@0+ (1,0) [0|3] "" XXX
 SG_ LAT_SPEED2 : 232|13@1- (0.01,0) [0|8191] "" XXX
 SG_ REL_ACCEL2 : 246|10@1- (0.05,0) [0|1023] "" XXX

BO_ 535 RADAR_TRACK_217: 32 RADAR
 SG_ NEW_SIGNAL_25 : 26|3@0+ (1,0) [0|7] "" XXX
 SG_ NEW_SIGNAL_24 : 28|2@0+ (1,0) [0|3] "" XXX
 SG_ NEW_SIGNAL_21 : 36|5@0+ (1,0) [0|31] "" XXX
 SG_ NEW_SIGNAL_20 : 39|3@0+ (1,0) [0|7] "" XXX
 SG_ VALID_CNT1 : 47|8@0+ (1,0) [0|255] "" XXX
 SG_ NEW_SIGNAL_15 : 51|4@0+ (1,0) [0|15] "" XXX
 SG_ NEW_SIGNAL_14 : 55|4@0+ (1,0) [0|15] "" XXX
 SG_ NEW_SIGNAL_5 : 63|8@0- (1,0) [0|255] "" XXX
 SG_ LONG_DIST1 : 64|12@1+ (0.05,0) [0|4095] "" XXX
 SG_ LAT_DIST1 : 76|12@1- (0.05,0) [0|4095] "" XXX
 SG_ REL_SPEED1 : 88|14@1- (0.01,0) [0|16383] "" XXX
 SG_ NEW_SIGNAL_16 : 103|2@0+ (1,0) [0|3] "" XXX
 SG_ LAT_SPEED1 : 104|13@1- (0.01,0) [0|8191] "" XXX
 SG_ REL_ACCEL1 : 118|10@1- (0.05,0) [0|1023] "" XXX
 SG_ NEW_SIGNAL_27 : 154|3@0+ (1,0) [0|7] "" XXX
 SG_ NEW_SIGNAL_26 : 156|2@0+ (1,0) [0|3] "" XXX
 SG_ NEW_SIGNAL_23 : 164|5@0+ (1,0) [0|31] "" XXX
 SG_ NEW_SIGNAL_22 : 167|3@0+ (1,0) [0|7] "" XXX
 SG_ VALID_CNT2 : 175|8@0+ (1,0) [0|255] "" XXX
 SG_ NEW_SIGNAL_13 : 179|4@0+ (1,0) [0|15] "" XXX
 SG_ NEW_SIGNAL_12 : 183|4@0+ (1,0) [0|15] "" XXX
 SG_ NEW_SIGNAL_11 : 191|8@0- (1,0) [0|255] "" XXX
 SG_ LONG_DIST2 : 192|12@1+ (0.05,0) [0|4095] "" XXX
 SG_ LAT_DIST2 : 204|12@1- (0.05,0) [0|4095] "" XXX
 SG_ REL_SPEED2 : 216|14@1- (0.01,0) [0|16383] "" XXX
 SG_ NEW_SIGNAL_17 : 231|2@0+ (1,0) [0|3] "" XXX
 SG_ LAT_SPEED2 : 232|13@1- (0.01,0) [0|8191] "" XXX
 SG_ REL_ACCEL2 : 246|10@1- (0.05,0) [0|1023] "" XXX

BO_ 536 RADAR_TRACK_218: 32 RADAR
 SG_ NEW_SIGNAL_25 : 26|3@0+ (1,0) [0|7] "" XXX
 SG_ NEW_SIGNAL_24 : 28|2@0+ (1,0) [0|3] "" XXX
 SG_ NEW_SIGNAL_21 : 36|5@0+ (1,0) [0|31] "" XXX
 SG_ NEW_SIGNAL_20 : 39|3@0+ (1,0) [0|7] "" XXX
 SG_ VALID_CNT1 : 47|8@0+ (1,0) [0|255] "" XXX
 SG_ NEW_SIGNAL_15 : 51|4@0+ (1,0) [0|15] "" XXX
 SG_ NEW_SIGNAL_14 : 55|4@0+ (1,0) [0|15] "" XXX
 SG_ NEW_SIGNAL_5 : 63|8@0- (1,0) [0|255] "" XXX
 SG_ LONG_DIST1 : 64|12@1+ (0.05,0) [0|4095] "" XXX
 SG_ LAT_DIST1 : 76|12@1- (0.05,0) [0|4095] "" XXX
 SG_ REL_SPEED1 : 88|14@1- (0.01,0) [0|16383] "" XXX
 SG_ NEW_SIGNAL_16 : 103|2@0+ (1,0) [0|3] "" XXX
 SG_ LAT_SPEED1 : 104|13@1- (0.01,0) [0|8191] "" XXX
 SG_ REL_ACCEL1 : 118|10@1- (0.05,0) [0|1023] "" XXX
 SG_ NEW_SIGNAL_27 : 154|3@0+ (1,0) [0|7] "" XXX
 SG_ NEW_SIGNAL_26 : 156|2@0+ (1,0) [0|3] "" XXX
 SG_ NEW_SIGNAL_23 : 164|5@0+ (1,0) [0|31] "" XXX
 SG_ NEW_SIGNAL_22 : 167|3@0+ (1,0) [0|7] "" XXX
 SG_ VALID_CNT2 : 175|8@0+ (1,0) [0|255] "" XXX
 SG_ NEW_SIGNAL_13 : 179|4@0+ (1,0) [0|15] "" XXX
 SG_ NEW_SIGNAL_12 : 183|4@0+ (1,0) [0|15] "" XXX
 SG_ NEW_SIGNAL_11 : 191|8@0- (1,0) [0|255] "" XXX
 SG_ LONG_DIST2 : 192|12@1+ (0.05,0) [0|4095] "" XXX
 SG_ LAT_DIST2 : 204|12@1- (0.05,0) [0|4095] "" XXX
 SG_ REL_SPEED2 : 216|14@1- (0.01,0) [0|16383] "" XXX
 SG_ NEW_SIGNAL_17 : 231|2@0+ (1,0) [0|3] "" XXX
 SG_ LAT_SPEED2 : 232|13@1- (0.01,0) [0|8191] "" XXX
 SG_ REL_ACCEL2 : 246|10@1- (0.05,0) [0|1023] "" XXX

BO_ 537 RADAR_TRACK_219: 32 RADAR
 SG_ NEW_SIGNAL_25 : 26|3@0+ (1,0) [0|7] "" XXX
 SG_ NEW_SIGNAL_24 : 28|2@0+ (1,0) [0|3] "" XXX
 SG_ NEW_SIGNAL_21 : 36|5@0+ (1,0) [0|31] "" XXX
 SG_ NEW_SIGNAL_20 : 39|3@0+ (1,0) [0|7] "" XXX
 SG_ VALID_CNT1 : 47|8@0+ (1,0) [0|255] "" XXX
 SG_ NEW_SIGNAL_15 : 51|4@0+ (1,0) [0|15] "" XXX
 SG_ NEW_SIGNAL_14 : 55|4@0+ (1,0) [0|15] "" XXX
 SG_ NEW_SIGNAL_5 : 63|8@0- (1,0) [0|255] "" XXX
 SG_ LONG_DIST1 : 64|12@1+ (0.05,0) [0|4095] "" XXX
 SG_ LAT_DIST1 : 76|12@1- (0.05,0) [0|4095] "" XXX
 SG_ REL_SPEED1 : 88|14@1- (0.01,0) [0|16383] "" XXX
 SG_ NEW_SIGNAL_16 : 103|2@0+ (1,0) [0|3] "" XXX
 SG_ LAT_SPEED1 : 104|13@1- (0.01,0) [0|8191] "" XXX
 SG_ REL_ACCEL1 : 118|10@1- (0.05,0) [0|1023] "" XXX
 SG_ NEW_SIGNAL_27 : 154|3@0+ (1,0) [0|7] "" XXX
 SG_ NEW_SIGNAL_26 : 156|2@0+ (1,0) [0|3] "" XXX
 SG_ NEW_SIGNAL_23 : 164|5@0+ (1,0) [0|31] "" XXX
 SG_ NEW_SIGNAL_22 : 167|3@0+ (1,0) [0|7] "" XXX
 SG_ VALID_CNT2 : 175|8@0+ (1,0) [0|255] "" XXX
 SG_ NEW_SIGNAL_13 : 179|4@0+ (1,0) [0|15] "" XXX
 SG_ NEW_SIGNAL_12 : 183|4@0+ (1,0) [0|15] "" XXX
 SG_ NEW_SIGNAL_11 : 191|8@0- (1,0) [0|255] "" XXX
 SG_ LONG_DIST2 : 192|12@1+ (0.05,0) [0|4095] "" XXX
 SG_ LAT_DIST2 : 204|12@1- (0.05,0) [0|4095] "" XXX
 SG_ REL_SPEED2 : 216|14@1- (0.01,0) [0|16383] "" XXX
 SG_ NEW_SIGNAL_17 : 231|2@0+ (1,0) [0|3] "" XXX
 SG_ LAT_SPEED2 : 232|13@1- (0.01,0) [0|8191] "" XXX
 SG_ REL_ACCEL2 : 246|10@1- (0.05,0) [0|1023] "" XXX

BO_ 538 RADAR_TRACK_21a: 32 RADAR
 SG_ NEW_SIGNAL_25 : 26|3@0+ (1,0) [0|7] "" XXX
 SG_ NEW_SIGNAL_24 : 28|2@0+ (1,0) [0|3] "" XXX
 SG_ NEW_SIGNAL_21 : 36|5@0+ (1,0) [0|31] "" XXX
 SG_ NEW_SIGNAL_20 : 39|3@0+ (1,0) [0|7] "" XXX
 SG_ VALID_CNT1 : 47|8@0+ (1,0) [0|255] "" XXX
 SG_ NEW_SIGNAL_15 : 51|4@0+ (1,0) [0|15] "" XXX
 SG_ NEW_SIGNAL_14 : 55|4@0+ (1,0) [0|15] "" XXX
 SG_ NEW_SIGNAL_5 : 63|8@0- (1,0) [0|255] "" XXX
 SG_ LONG_DIST1 : 64|12@1+ (0.05,0) [0|4095] "" XXX
 SG_ LAT_DIST1 : 76|12@1- (0.05,0) [0|4095] "" XXX
 SG_ REL_SPEED1 : 88|14@1- (0.01,0) [0|16383] "" XXX
 SG_ NEW_SIGNAL_16 : 103|2@0+ (1,0) [0|3] "" XXX
 SG_ LAT_SPEED1 : 104|13@1- (0.01,0) [0|8191] "" XXX
 SG_ REL_ACCEL1 : 118|10@1- (0.05,0) [0|1023] "" XXX
 SG_ NEW_SIGNAL_27 : 154|3@0+ (1,0) [0|7] "" XXX
 SG_ NEW_SIGNAL_26 : 156|2@0+ (1,0) [0|3] "" XXX
 SG_ NEW_SIGNAL_23 : 164|5@0+ (1,0) [0|31] "" XXX
 SG_ NEW_SIGNAL_22 : 167|3@0+ (1,0) [0|7] "" XXX
 SG_ VALID_CNT2 : 175|8@0+ (1,0) [0|255] "" XXX
 SG_ NEW_SIGNAL_13 : 179|4@0+ (1,0) [0|15] "" XXX
 SG_ NEW_SIGNAL_12 : 183|4@0+ (1,0) [0|15] "" XXX
 SG_ NEW_SIGNAL_11 : 191|8@0- (1,0) [0|255] "" XXX
 SG_ LONG_DIST2 : 192|12@1+ (0.05,0) [0|4095] "" XXX
 SG_ LAT_DIST2 : 204|12@1- (0.05,0) [0|4095] "" XXX
 SG_ REL_SPEED2 : 216|14@1- (0.01,0) [0|16383] "" XXX
 SG_ NEW_SIGNAL_17 : 231|2@0+ (1,0) [0|3] "" XXX
 SG_ LAT_SPEED2 : 232|13@1- (0.01,0) [0|8191] "" XXX
 SG_ REL_ACCEL2 : 246|10@1- (0.05,0) [0|1023] "" XXX

BO_ 539 RADAR_TRACK_21b: 32 RADAR
 SG_ NEW_SIGNAL_25 : 26|3@0+ (1,0) [0|7] "" XXX
 SG_ NEW_SIGNAL_24 : 28|2@0+ (1,0) [0|3] "" XXX
 SG_ NEW_SIGNAL_21 : 36|5@0+ (1,0) [0|31] "" XXX
 SG_ NEW_SIGNAL_20 : 39|3@0+ (1,0) [0|7] "" XXX
 SG_ VALID_CNT1 : 47|8@0+ (1,0) [0|255] "" XXX
 SG_ NEW_SIGNAL_15 : 51|4@0+ (1,0) [0|15] "" XXX
 SG_ NEW_SIGNAL_14 : 55|4@0+ (1,0) [0|15] "" XXX
 SG_ NEW_SIGNAL_5 : 63|8@0- (1,0) [0|255] "" XXX
 SG_ LONG_DIST1 : 64|12@1+ (0.05,0) [0|4095] "" XXX
 SG_ LAT_DIST1 : 76|12@1- (0.05,0) [0|4095] "" XXX
 SG_ REL_SPEED1 : 88|14@1- (0.01,0) [0|16383] "" XXX
 SG_ NEW_SIGNAL_16 : 103|2@0+ (1,0) [0|3] "" XXX
 SG_ LAT_SPEED1 : 104|13@1- (0.01,0) [0|8191] "" XXX
 SG_ REL_ACCEL1 : 118|10@1- (0.05,0) [0|1023] "" XXX
 SG_ NEW_SIGNAL_27 : 154|3@0+ (1,0) [0|7] "" XXX
 SG_ NEW_SIGNAL_26 : 156|2@0+ (1,0) [0|3] "" XXX
 SG_ NEW_SIGNAL_23 : 164|5@0+ (1,0) [0|31] "" XXX
 SG_ NEW_SIGNAL_22 : 167|3@0+ (1,0) [0|7] "" XXX
 SG_ VALID_CNT2 : 175|8@0+ (1,0) [0|255] "" XXX
 SG_ NEW_SIGNAL_13 : 179|4@0+ (1,0) [0|15] "" XXX
 SG_ NEW_SIGNAL_12 : 183|4@0+ (1,0) [0|15] "" XXX
 SG_ NEW_SIGNAL_11 : 191|8@0- (1,0) [0|255] "" XXX
 SG_ LONG_DIST2 : 192|12@1+ (0.05,0) [0|4095] "" XXX
 SG_ LAT_DIST2 : 204|12@1- (0.05,0) [0|4095] "" XXX
 SG_ REL_SPEED2 : 216|14@1- (0.01,0) [0|16383] "" XXX
 SG_ NEW_SIGNAL_17 : 231|2@0+ (1,0) [0|3] "" XXX
 SG_ LAT_SPEED2 : 232|13@1- (0.01,0) [0|8191] "" XXX
 SG_ REL_ACCEL2 : 246|10@1- (0.05,0) [0|1023] "" XXX

BO_ 540 RADAR_TRACK_21c: 32 RADAR
 SG_ NEW_SIGNAL_25 : 26|3@0+ (1,0) [0|7] "" XXX
 SG_ NEW_SIGNAL_24 : 28|2@0+ (1,0) [0|3] "" XXX
 SG_ NEW_SIGNAL_21 : 36|5@0+ (1,0) [0|31] "" XXX
 SG_ NEW_SIGNAL_20 : 39|3@0+ (1,0) [0|7] "" XXX
 SG_ VALID_CNT1 : 47|8@0+ (1,0) [0|255] "" XXX
 SG_ NEW_SIGNAL_15 : 51|4@0+ (1,0) [0|15] "" XXX
 SG_ NEW_SIGNAL_14 : 55|4@0+ (1,0) [0|15] "" XXX
 SG_ NEW_SIGNAL_5 : 63|8@0- (1,0) [0|255] "" XXX
 SG_ LONG_DIST1 : 64|12@1+ (0.05,0) [0|4095] "" XXX
 SG_ LAT_DIST1 : 76|12@1- (0.05,0) [0|4095] "" XXX
 SG_ REL_SPEED1 : 88|14@1- (0.01,0) [0|16383] "" XXX
 SG_ NEW_SIGNAL_16 : 103|2@0+ (1,0) [0|3] "" XXX
 SG_ LAT_SPEED1 : 104|13@1- (0.01,0) [0|8191] "" XXX
 SG_ REL_ACCEL1 : 118|10@1- (0.05,0) [0|1023] "" XXX
 SG_ NEW_SIGNAL_27 : 154|3@0+ (1,0) [0|7] "" XXX
 SG_ NEW_SIGNAL_26 : 156|2@0+ (1,0) [0|3] "" XXX
 SG_ NEW_SIGNAL_23 : 164|5@0+ (1,0) [0|31] "" XXX
 SG_ NEW_SIGNAL_22 : 167|3@0+ (1,0) [0|7] "" XXX
 SG_ VALID_CNT2 : 175|8@0+ (1,0) [0|255] "" XXX
 SG_ NEW_SIGNAL_13 : 179|4@0+ (1,0) [0|15] "" XXX
 SG_ NEW_SIGNAL_12 : 183|4@0+ (1,0) [0|15] "" XXX
 SG_ NEW_SIGNAL_11 : 191|8@0- (1,0) [0|255] "" XXX
 SG_ LONG_DIST2 : 192|12@1+ (0.05,0) [0|4095] "" XXX
 SG_ LAT_DIST2 : 204|12@1- (0.05,0) [0|4095] "" XXX
 SG_ REL_SPEED2 : 216|14@1- (0.01,0) [0|16383] "" XXX
 SG_ NEW_SIGNAL_17 : 231|2@0+ (1,0) [0|3] "" XXX
 SG_ LAT_SPEED2 : 232|13@1- (0.01,0) [0|8191] "" XXX
 SG_ REL_ACCEL2 : 246|10@1- (0.05,0) [0|1023] "" XXX

BO_ 541 RADAR_TRACK_21d: 32 RADAR
 SG_ NEW_SIGNAL_25 : 26|3@0+ (1,0) [0|7] "" XXX
 SG_ NEW_SIGNAL_24 : 28|2@0+ (1,0) [0|3] "" XXX
 SG_ NEW_SIGNAL_21 : 36|5@0+ (1,0) [0|31] "" XXX
 SG_ NEW_SIGNAL_20 : 39|3@0+ (1,0) [0|7] "" XXX
 SG_ VALID_CNT1 : 47|8@0+ (1,0) [0|255] "" XXX
 SG_ NEW_SIGNAL_15 : 51|4@0+ (1,0) [0|15] "" XXX
 SG_ NEW_SIGNAL_14 : 55|4@0+ (1,0) [0|15] "" XXX
 SG_ NEW_SIGNAL_5 : 63|8@0- (1,0) [0|255] "" XXX
 SG_ LONG_DIST1 : 64|12@1+ (0.05,0) [0|4095] "" XXX
 SG_ LAT_DIST1 : 76|12@1- (0.05,0) [0|4095] "" XXX
 SG_ REL_SPEED1 : 88|14@1- (0.01,0) [0|16383] "" XXX
 SG_ NEW_SIGNAL_16 : 103|2@0+ (1,0) [0|3] "" XXX
 SG_ LAT_SPEED1 : 104|13@1- (0.01,0) [0|8191] "" XXX
 SG_ REL_ACCEL1 : 118|10@1- (0.05,0) [0|1023] "" XXX
 SG_ NEW_SIGNAL_27 : 154|3@0+ (1,0) [0|7] "" XXX
 SG_ NEW_SIGNAL_26 : 156|2@0+ (1,0) [0|3] "" XXX
 SG_ NEW_SIGNAL_23 : 164|5@0+ (1,0) [0|31] "" XXX
 SG_ NEW_SIGNAL_22 : 167|3@0+ (1,0) [0|7] "" XXX
 SG_ VALID_CNT2 : 175|8@0+ (1,0) [0|255] "" XXX
 SG_ NEW_SIGNAL_13 : 179|4@0+ (1,0) [0|15] "" XXX
 SG_ NEW_SIGNAL_12 : 183|4@0+ (1,0) [0|15] "" XXX
 SG_ NEW_SIGNAL_11 : 191|8@0- (1,0) [0|255] "" XXX
 SG_ LONG_DIST2 : 192|12@1+ (0.05,0) [0|4095] "" XXX
 SG_ LAT_DIST2 : 204|12@1- (0.05,0) [0|4095] "" XXX
 SG_ REL_SPEED2 : 216|14@1- (0.01,0) [0|16383] "" XXX
 SG_ NEW_SIGNAL_17 : 231|2@0+ (1,0) [0|3] "" XXX
 SG_ LAT_SPEED2 : 232|13@1- (0.01,0) [0|8191] "" XXX
 SG_ REL_ACCEL2 : 246|10@1- (0.05,0) [0|1023] "" XXX

BO_ 542 RADAR_TRACK_21e: 32 RADAR
 SG_ NEW_SIGNAL_25 : 26|3@0+ (1,0) [0|7] "" XXX
 SG_ NEW_SIGNAL_24 : 28|2@0+ (1,0) [0|3] "" XXX
 SG_ NEW_SIGNAL_21 : 36|5@0+ (1,0) [0|31] "" XXX
 SG_ NEW_SIGNAL_20 : 39|3@0+ (1,0) [0|7] "" XXX
 SG_ VALID_CNT1 : 47|8@0+ (1,0) [0|255] "" XXX
 SG_ NEW_SIGNAL_15 : 51|4@0+ (1,0) [0|15] "" XXX
 SG_ NEW_SIGNAL_14 : 55|4@0+ (1,0) [0|15] "" XXX
 SG_ NEW_SIGNAL_5 : 63|8@0- (1,0) [0|255] "" XXX
 SG_ LONG_DIST1 : 64|12@1+ (0.05,0) [0|4095] "" XXX
 SG_ LAT_DIST1 : 76|12@1- (0.05,0) [0|4095] "" XXX
 SG_ REL_SPEED1 : 88|14@1- (0.01,0) [0|16383] "" XXX
 SG_ NEW_SIGNAL_16 : 103|2@0+ (1,0) [0|3] "" XXX
 SG_ LAT_SPEED1 : 104|13@1- (0.01,0) [0|8191] "" XXX
 SG_ REL_ACCEL1 : 118|10@1- (0.05,0) [0|1023] "" XXX
 SG_ NEW_SIGNAL_27 : 154|3@0+ (1,0) [0|7] "" XXX
 SG_ NEW_SIGNAL_26 : 156|2@0+ (1,0) [0|3] "" XXX
 SG_ NEW_SIGNAL_23 : 164|5@0+ (1,0) [0|31] "" XXX
 SG_ NEW_SIGNAL_22 : 167|3@0+ (1,0) [0|7] "" XXX
 SG_ VALID_CNT2 : 175|8@0+ (1,0) [0|255] "" XXX
 SG_ NEW_SIGNAL_13 : 179|4@0+ (1,0) [0|15] "" XXX
 SG_ NEW_SIGNAL_12 : 183|4@0+ (1,0) [0|15] "" XXX
 SG_ NEW_SIGNAL_11 : 191|8@0- (1,0) [0|255] "" XXX
 SG_ LONG_DIST2 : 192|12@1+ (0.05,0) [0|4095] "" XXX
 SG_ LAT_DIST2 : 204|12@1- (0.05,0) [0|4095] "" XXX
 SG_ REL_SPEED2 : 216|14@1- (0.01,0) [0|16383] "" XXX
 SG_ NEW_SIGNAL_17 : 231|2@0+ (1,0) [0|3] "" XXX
 SG_ LAT_SPEED2 : 232|13@1- (0.01,0) [0|8191] "" XXX
 SG_ REL_ACCEL2 : 246|10@1- (0.05,0) [0|1023] "" XXX

BO_ 543 RADAR_TRACK_21f: 32 RADAR
 SG_ NEW_SIGNAL_25 : 26|3@0+ (1,0) [0|7] "" XXX
 SG_ NEW_SIGNAL_24 : 28|2@0+ (1,0) [0|3] "" XXX
 SG_ NEW_SIGNAL_21 : 36|5@0+ (1,0) [0|31] "" XXX
 SG_ NEW_SIGNAL_20 : 39|3@0+ (1,0) [0|7] "" XXX
 SG_ VALID_CNT1 : 47|8@0+ (1,0) [0|255] "" XXX
 SG_ NEW_SIGNAL_15 : 51|4@0+ (1,0) [0|15] "" XXX
 SG_ NEW_SIGNAL_14 : 55|4@0+ (1,0) [0|15] "" XXX
 SG_ NEW_SIGNAL_5 : 63|8@0- (1,0) [0|255] "" XXX
 SG_ LONG_DIST1 : 64|12@1+ (0.05,0) [0|4095] "" XXX
 SG_ LAT_DIST1 : 76|12@1- (0.05,0) [0|4095] "" XXX
 SG_ REL_SPEED1 : 88|14@1- (0.01,0) [0|16383] "" XXX
 SG_ NEW_SIGNAL_16 : 103|2@0+ (1,0) [0|3] "" XXX
 SG_ LAT_SPEED1 : 104|13@1- (0.01,0) [0|8191] "" XXX
 SG_ REL_ACCEL1 : 118|10@1- (0.05,0) [0|1023] "" XXX
 SG_ NEW_SIGNAL_27 : 154|3@0+ (1,0) [0|7] "" XXX
 SG_ NEW_SIGNAL_26 : 156|2@0+ (1,0) [0|3] "" XXX
 SG_ NEW_SIGNAL_23 : 164|5@0+ (1,0) [0|31] "" XXX
 SG_ NEW_SIGNAL_22 : 167|3@0+ (1,0) [0|7] "" XXX
 SG_ VALID_CNT2 : 175|8@0+ (1,0) [0|255] "" XXX
 SG_ NEW_SIGNAL_13 : 179|4@0+ (1,0) [0|15] "" XXX
 SG_ NEW_SIGNAL_12 : 183|4@0+ (1,0) [0|15] "" XXX
 SG_ NEW_SIGNAL_11 : 191|8@0- (1,0) [0|255] "" XXX
 SG_ LONG_DIST2 : 192|12@1+ (0.05,0) [0|4095] "" XXX
 SG_ LAT_DIST2 : 204|12@1- (0.05,0) [0|4095] "" XXX
 SG_ REL_SPEED2 : 216|14@1- (0.01,0) [0|16383] "" XXX
 SG_ NEW_SIGNAL_17 : 231|2@0+ (1,0) [0|3] "" XXX
 SG_ LAT_SPEED2 : 232|13@1- (0.01,0) [0|8191] "" XXX
 SG_ REL_ACCEL2 : 246|10@1- (0.05,0) [0|1023] "" XXX

BO_ 933 RADAR_TRACK_3a5: 24 RADAR
 SG_ VALID : 25|2@0+ (1,0) [0|3] "" XXX
 SG_ VALID2 : 28|2@0+ (1,0) [0|3] "" XXX
 SG_ PROB : 30|10@1+ (1,0) [0|1023] "" XXX
 SG_ VALID_CNT : 47|8@0+ (1,0) [0|255] "" XXX
 SG_ NEW_SIGNAL_7 : 51|4@0+ (1,0) [0|15] "" XXX
 SG_ NEW_SIGNAL_6 : 55|4@0+ (1,0) [0|15] "" XXX
 SG_ NEW_SIGNAL_2 : 62|7@0- (1,0) [0|127] "" XXX
 SG_ LONG_DIST : 63|13@1+ (0.05,0) [0|8191] "" XXX
 SG_ LAT_DIST : 76|12@1- (0.05,0) [0|4095] "" XXX
 SG_ REL_SPEED : 88|14@1- (0.01,0) [0|16383] "" XXX
 SG_ IN_MYLANE : 103|2@0+ (1,0) [0|3] "" XXX
 SG_ LAT_SPEED : 104|13@1- (0.01,0) [0|8191] "" XXX
 SG_ REL_ACCEL : 118|10@1- (0.05,0) [0|1023] "" XXX

BO_ 934 RADAR_TRACK_3a6: 24 RADAR
 SG_ VALID : 25|2@0+ (1,0) [0|3] "" XXX
 SG_ VALID2 : 28|2@0+ (1,0) [0|3] "" XXX
 SG_ PROB : 30|10@1+ (1,0) [0|1023] "" XXX
 SG_ VALID_CNT : 47|8@0+ (1,0) [0|255] "" XXX
 SG_ NEW_SIGNAL_7 : 51|4@0+ (1,0) [0|15] "" XXX
 SG_ NEW_SIGNAL_6 : 55|4@0+ (1,0) [0|15] "" XXX
 SG_ NEW_SIGNAL_2 : 62|7@0- (1,0) [0|127] "" XXX
 SG_ LONG_DIST : 63|13@1+ (0.05,0) [0|8191] "" XXX
 SG_ LAT_DIST : 76|12@1- (0.05,0) [0|4095] "" XXX
 SG_ REL_SPEED : 88|14@1- (0.01,0) [0|16383] "" XXX
 SG_ IN_MYLANE : 103|2@0+ (1,0) [0|3] "" XXX
 SG_ LAT_SPEED : 104|13@1- (0.01,0) [0|8191] "" XXX
 SG_ REL_ACCEL : 118|10@1- (0.05,0) [0|1023] "" XXX

BO_ 935 RADAR_TRACK_3a7: 24 RADAR
 SG_ VALID : 25|2@0+ (1,0) [0|3] "" XXX
 SG_ VALID2 : 28|2@0+ (1,0) [0|3] "" XXX
 SG_ PROB : 30|10@1+ (1,0) [0|1023] "" XXX
 SG_ VALID_CNT : 47|8@0+ (1,0) [0|255] "" XXX
 SG_ NEW_SIGNAL_7 : 51|4@0+ (1,0) [0|15] "" XXX
 SG_ NEW_SIGNAL_6 : 55|4@0+ (1,0) [0|15] "" XXX
 SG_ NEW_SIGNAL_2 : 62|7@0- (1,0) [0|127] "" XXX
 SG_ LONG_DIST : 63|13@1+ (0.05,0) [0|8191] "" XXX
 SG_ LAT_DIST : 76|12@1- (0.05,0) [0|4095] "" XXX
 SG_ REL_SPEED : 88|14@1- (0.01,0) [0|16383] "" XXX
 SG_ IN_MYLANE : 103|2@0+ (1,0) [0|3] "" XXX
 SG_ LAT_SPEED : 104|13@1- (0.01,0) [0|8191] "" XXX
 SG_ REL_ACCEL : 118|10@1- (0.05,0) [0|1023] "" XXX

BO_ 936 RADAR_TRACK_3a8: 24 RADAR
 SG_ VALID : 25|2@0+ (1,0) [0|3] "" XXX
 SG_ VALID2 : 28|2@0+ (1,0) [0|3] "" XXX
 SG_ PROB : 30|10@1+ (1,0) [0|1023] "" XXX
 SG_ VALID_CNT : 47|8@0+ (1,0) [0|255] "" XXX
 SG_ NEW_SIGNAL_7 : 51|4@0+ (1,0) [0|15] "" XXX
 SG_ NEW_SIGNAL_6 : 55|4@0+ (1,0) [0|15] "" XXX
 SG_ NEW_SIGNAL_2 : 62|7@0- (1,0) [0|127] "" XXX
 SG_ LONG_DIST : 63|13@1+ (0.05,0) [0|8191] "" XXX
 SG_ LAT_DIST : 76|12@1- (0.05,0) [0|4095] "" XXX
 SG_ REL_SPEED : 88|14@1- (0.01,0) [0|16383] "" XXX
 SG_ IN_MYLANE : 103|2@0+ (1,0) [0|3] "" XXX
 SG_ LAT_SPEED : 104|13@1- (0.01,0) [0|8191] "" XXX
 SG_ REL_ACCEL : 118|10@1- (0.05,0) [0|1023] "" XXX

BO_ 937 RADAR_TRACK_3a9: 24 RADAR
 SG_ VALID : 25|2@0+ (1,0) [0|3] "" XXX
 SG_ VALID2 : 28|2@0+ (1,0) [0|3] "" XXX
 SG_ PROB : 30|10@1+ (1,0) [0|1023] "" XXX
 SG_ VALID_CNT : 47|8@0+ (1,0) [0|255] "" XXX
 SG_ NEW_SIGNAL_7 : 51|4@0+ (1,0) [0|15] "" XXX
 SG_ NEW_SIGNAL_6 : 55|4@0+ (1,0) [0|15] "" XXX
 SG_ NEW_SIGNAL_2 : 62|7@0- (1,0) [0|127] "" XXX
 SG_ LONG_DIST : 63|13@1+ (0.05,0) [0|8191] "" XXX
 SG_ LAT_DIST : 76|12@1- (0.05,0) [0|4095] "" XXX
 SG_ REL_SPEED : 88|14@1- (0.01,0) [0|16383] "" XXX
 SG_ IN_MYLANE : 103|2@0+ (1,0) [0|3] "" XXX
 SG_ LAT_SPEED : 104|13@1- (0.01,0) [0|8191] "" XXX
 SG_ REL_ACCEL : 118|10@1- (0.05,0) [0|1023] "" XXX

BO_ 938 RADAR_TRACK_3aa: 24 RADAR
 SG_ VALID : 25|2@0+ (1,0) [0|3] "" XXX
 SG_ VALID2 : 28|2@0+ (1,0) [0|3] "" XXX
 SG_ PROB : 30|10@1+ (1,0) [0|1023] "" XXX
 SG_ VALID_CNT : 47|8@0+ (1,0) [0|255] "" XXX
 SG_ NEW_SIGNAL_7 : 51|4@0+ (1,0) [0|15] "" XXX
 SG_ NEW_SIGNAL_6 : 55|4@0+ (1,0) [0|15] "" XXX
 SG_ NEW_SIGNAL_2 : 62|7@0- (1,0) [0|127] "" XXX
 SG_ LONG_DIST : 63|13@1+ (0.05,0) [0|8191] "" XXX
 SG_ LAT_DIST : 76|12@1- (0.05,0) [0|4095] "" XXX
 SG_ REL_SPEED : 88|14@1- (0.01,0) [0|16383] "" XXX
 SG_ IN_MYLANE : 103|2@0+ (1,0) [0|3] "" XXX
 SG_ LAT_SPEED : 104|13@1- (0.01,0) [0|8191] "" XXX
 SG_ REL_ACCEL : 118|10@1- (0.05,0) [0|1023] "" XXX

BO_ 939 RADAR_TRACK_3ab: 24 RADAR
 SG_ VALID : 25|2@0+ (1,0) [0|3] "" XXX
 SG_ VALID2 : 28|2@0+ (1,0) [0|3] "" XXX
 SG_ PROB : 30|10@1+ (1,0) [0|1023] "" XXX
 SG_ VALID_CNT : 47|8@0+ (1,0) [0|255] "" XXX
 SG_ NEW_SIGNAL_7 : 51|4@0+ (1,0) [0|15] "" XXX
 SG_ NEW_SIGNAL_6 : 55|4@0+ (1,0) [0|15] "" XXX
 SG_ NEW_SIGNAL_2 : 62|7@0- (1,0) [0|127] "" XXX
 SG_ LONG_DIST : 63|13@1+ (0.05,0) [0|8191] "" XXX
 SG_ LAT_DIST : 76|12@1- (0.05,0) [0|4095] "" XXX
 SG_ REL_SPEED : 88|14@1- (0.01,0) [0|16383] "" XXX
 SG_ IN_MYLANE : 103|2@0+ (1,0) [0|3] "" XXX
 SG_ LAT_SPEED : 104|13@1- (0.01,0) [0|8191] "" XXX
 SG_ REL_ACCEL : 118|10@1- (0.05,0) [0|1023] "" XXX

BO_ 940 RADAR_TRACK_3ac: 24 RADAR
 SG_ VALID : 25|2@0+ (1,0) [0|3] "" XXX
 SG_ VALID2 : 28|2@0+ (1,0) [0|3] "" XXX
 SG_ PROB : 30|10@1+ (1,0) [0|1023] "" XXX
 SG_ VALID_CNT : 47|8@0+ (1,0) [0|255] "" XXX
 SG_ NEW_SIGNAL_7 : 51|4@0+ (1,0) [0|15] "" XXX
 SG_ NEW_SIGNAL_6 : 55|4@0+ (1,0) [0|15] "" XXX
 SG_ NEW_SIGNAL_2 : 62|7@0- (1,0) [0|127] "" XXX
 SG_ LONG_DIST : 63|13@1+ (0.05,0) [0|8191] "" XXX
 SG_ LAT_DIST : 76|12@1- (0.05,0) [0|4095] "" XXX
 SG_ REL_SPEED : 88|14@1- (0.01,0) [0|16383] "" XXX
 SG_ IN_MYLANE : 103|2@0+ (1,0) [0|3] "" XXX
 SG_ LAT_SPEED : 104|13@1- (0.01,0) [0|8191] "" XXX
 SG_ REL_ACCEL : 118|10@1- (0.05,0) [0|1023] "" XXX

BO_ 941 RADAR_TRACK_3ad: 24 RADAR
 SG_ VALID : 25|2@0+ (1,0) [0|3] "" XXX
 SG_ VALID2 : 28|2@0+ (1,0) [0|3] "" XXX
 SG_ PROB : 30|10@1+ (1,0) [0|1023] "" XXX
 SG_ VALID_CNT : 47|8@0+ (1,0) [0|255] "" XXX
 SG_ NEW_SIGNAL_7 : 51|4@0+ (1,0) [0|15] "" XXX
 SG_ NEW_SIGNAL_6 : 55|4@0+ (1,0) [0|15] "" XXX
 SG_ NEW_SIGNAL_2 : 62|7@0- (1,0) [0|127] "" XXX
 SG_ LONG_DIST : 63|13@1+ (0.05,0) [0|8191] "" XXX
 SG_ LAT_DIST : 76|12@1- (0.05,0) [0|4095] "" XXX
 SG_ REL_SPEED : 88|14@1- (0.01,0) [0|16383] "" XXX
 SG_ IN_MYLANE : 103|2@0+ (1,0) [0|3] "" XXX
 SG_ LAT_SPEED : 104|13@1- (0.01,0) [0|8191] "" XXX
 SG_ REL_ACCEL : 118|10@1- (0.05,0) [0|1023] "" XXX

BO_ 942 RADAR_TRACK_3ae: 24 RADAR
 SG_ VALID : 25|2@0+ (1,0) [0|3] "" XXX
 SG_ VALID2 : 28|2@0+ (1,0) [0|3] "" XXX
 SG_ PROB : 30|10@1+ (1,0) [0|1023] "" XXX
 SG_ VALID_CNT : 47|8@0+ (1,0) [0|255] "" XXX
 SG_ NEW_SIGNAL_7 : 51|4@0+ (1,0) [0|15] "" XXX
 SG_ NEW_SIGNAL_6 : 55|4@0+ (1,0) [0|15] "" XXX
 SG_ NEW_SIGNAL_2 : 62|7@0- (1,0) [0|127] "" XXX
 SG_ LONG_DIST : 63|13@1+ (0.05,0) [0|8191] "" XXX
 SG_ LAT_DIST : 76|12@1- (0.05,0) [0|4095] "" XXX
 SG_ REL_SPEED : 88|14@1- (0.01,0) [0|16383] "" XXX
 SG_ IN_MYLANE : 103|2@0+ (1,0) [0|3] "" XXX
 SG_ LAT_SPEED : 104|13@1- (0.01,0) [0|8191] "" XXX
 SG_ REL_ACCEL : 118|10@1- (0.05,0) [0|1023] "" XXX

BO_ 943 RADAR_TRACK_3af: 24 RADAR
 SG_ VALID : 25|2@0+ (1,0) [0|3] "" XXX
 SG_ VALID2 : 28|2@0+ (1,0) [0|3] "" XXX
 SG_ PROB : 30|10@1+ (1,0) [0|1023] "" XXX
 SG_ VALID_CNT : 47|8@0+ (1,0) [0|255] "" XXX
 SG_ NEW_SIGNAL_7 : 51|4@0+ (1,0) [0|15] "" XXX
 SG_ NEW_SIGNAL_6 : 55|4@0+ (1,0) [0|15] "" XXX
 SG_ NEW_SIGNAL_2 : 62|7@0- (1,0) [0|127] "" XXX
 SG_ LONG_DIST : 63|13@1+ (0.05,0) [0|8191] "" XXX
 SG_ LAT_DIST : 76|12@1- (0.05,0) [0|4095] "" XXX
 SG_ REL_SPEED : 88|14@1- (0.01,0) [0|16383] "" XXX
 SG_ IN_MYLANE : 103|2@0+ (1,0) [0|3] "" XXX
 SG_ LAT_SPEED : 104|13@1- (0.01,0) [0|8191] "" XXX
 SG_ REL_ACCEL : 118|10@1- (0.05,0) [0|1023] "" XXX

BO_ 944 RADAR_TRACK_3b0: 24 RADAR
 SG_ VALID : 25|2@0+ (1,0) [0|3] "" XXX
 SG_ VALID2 : 28|2@0+ (1,0) [0|3] "" XXX
 SG_ PROB : 30|10@1+ (1,0) [0|1023] "" XXX
 SG_ VALID_CNT : 47|8@0+ (1,0) [0|255] "" XXX
 SG_ NEW_SIGNAL_7 : 51|4@0+ (1,0) [0|15] "" XXX
 SG_ NEW_SIGNAL_6 : 55|4@0+ (1,0) [0|15] "" XXX
 SG_ NEW_SIGNAL_2 : 62|7@0- (1,0) [0|127] "" XXX
 SG_ LONG_DIST : 63|13@1+ (0.05,0) [0|8191] "" XXX
 SG_ LAT_DIST : 76|12@1- (0.05,0) [0|4095] "" XXX
 SG_ REL_SPEED : 88|14@1- (0.01,0) [0|16383] "" XXX
 SG_ IN_MYLANE : 103|2@0+ (1,0) [0|3] "" XXX
 SG_ LAT_SPEED : 104|13@1- (0.01,0) [0|8191] "" XXX
 SG_ REL_ACCEL : 118|10@1- (0.05,0) [0|1023] "" XXX

BO_ 945 RADAR_TRACK_3b1: 24 RADAR
 SG_ VALID : 25|2@0+ (1,0) [0|3] "" XXX
 SG_ VALID2 : 28|2@0+ (1,0) [0|3] "" XXX
 SG_ PROB : 30|10@1+ (1,0) [0|1023] "" XXX
 SG_ VALID_CNT : 47|8@0+ (1,0) [0|255] "" XXX
 SG_ NEW_SIGNAL_7 : 51|4@0+ (1,0) [0|15] "" XXX
 SG_ NEW_SIGNAL_6 : 55|4@0+ (1,0) [0|15] "" XXX
 SG_ NEW_SIGNAL_2 : 62|7@0- (1,0) [0|127] "" XXX
 SG_ LONG_DIST : 63|13@1+ (0.05,0) [0|8191] "" XXX
 SG_ LAT_DIST : 76|12@1- (0.05,0) [0|4095] "" XXX
 SG_ REL_SPEED : 88|14@1- (0.01,0) [0|16383] "" XXX
 SG_ IN_MYLANE : 103|2@0+ (1,0) [0|3] "" XXX
 SG_ LAT_SPEED : 104|13@1- (0.01,0) [0|8191] "" XXX
 SG_ REL_ACCEL : 118|10@1- (0.05,0) [0|1023] "" XXX

BO_ 946 RADAR_TRACK_3b2: 24 RADAR
 SG_ VALID : 25|2@0+ (1,0) [0|3] "" XXX
 SG_ VALID2 : 28|2@0+ (1,0) [0|3] "" XXX
 SG_ PROB : 30|10@1+ (1,0) [0|1023] "" XXX
 SG_ VALID_CNT : 47|8@0+ (1,0) [0|255] "" XXX
 SG_ NEW_SIGNAL_7 : 51|4@0+ (1,0) [0|15] "" XXX
 SG_ NEW_SIGNAL_6 : 55|4@0+ (1,0) [0|15] "" XXX
 SG_ NEW_SIGNAL_2 : 62|7@0- (1,0) [0|127] "" XXX
 SG_ LONG_DIST : 63|13@1+ (0.05,0) [0|8191] "" XXX
 SG_ LAT_DIST : 76|12@1- (0.05,0) [0|4095] "" XXX
 SG_ REL_SPEED : 88|14@1- (0.01,0) [0|16383] "" XXX
 SG_ IN_MYLANE : 103|2@0+ (1,0) [0|3] "" XXX
 SG_ LAT_SPEED : 104|13@1- (0.01,0) [0|8191] "" XXX
 SG_ REL_ACCEL : 118|10@1- (0.05,0) [0|1023] "" XXX

BO_ 947 RADAR_TRACK_3b3: 24 RADAR
 SG_ VALID : 25|2@0+ (1,0) [0|3] "" XXX
 SG_ VALID2 : 28|2@0+ (1,0) [0|3] "" XXX
 SG_ PROB : 30|10@1+ (1,0) [0|1023] "" XXX
 SG_ VALID_CNT : 47|8@0+ (1,0) [0|255] "" XXX
 SG_ NEW_SIGNAL_7 : 51|4@0+ (1,0) [0|15] "" XXX
 SG_ NEW_SIGNAL_6 : 55|4@0+ (1,0) [0|15] "" XXX
 SG_ NEW_SIGNAL_2 : 62|7@0- (1,0) [0|127] "" XXX
 SG_ LONG_DIST : 63|13@1+ (0.05,0) [0|8191] "" XXX
 SG_ LAT_DIST : 76|12@1- (0.05,0) [0|4095] "" XXX
 SG_ REL_SPEED : 88|14@1- (0.01,0) [0|16383] "" XXX
 SG_ IN_MYLANE : 103|2@0+ (1,0) [0|3] "" XXX
 SG_ LAT_SPEED : 104|13@1- (0.01,0) [0|8191] "" XXX
 SG_ REL_ACCEL : 118|10@1- (0.05,0) [0|1023] "" XXX

BO_ 948 RADAR_TRACK_3b4: 24 RADAR
 SG_ VALID : 25|2@0+ (1,0) [0|3] "" XXX
 SG_ VALID2 : 28|2@0+ (1,0) [0|3] "" XXX
 SG_ PROB : 30|10@1+ (1,0) [0|1023] "" XXX
 SG_ VALID_CNT : 47|8@0+ (1,0) [0|255] "" XXX
 SG_ NEW_SIGNAL_7 : 51|4@0+ (1,0) [0|15] "" XXX
 SG_ NEW_SIGNAL_6 : 55|4@0+ (1,0) [0|15] "" XXX
 SG_ NEW_SIGNAL_2 : 62|7@0- (1,0) [0|127] "" XXX
 SG_ LONG_DIST : 63|13@1+ (0.05,0) [0|8191] "" XXX
 SG_ LAT_DIST : 76|12@1- (0.05,0) [0|4095] "" XXX
 SG_ REL_SPEED : 88|14@1- (0.01,0) [0|16383] "" XXX
 SG_ IN_MYLANE : 103|2@0+ (1,0) [0|3] "" XXX
 SG_ LAT_SPEED : 104|13@1- (0.01,0) [0|8191] "" XXX
 SG_ REL_ACCEL : 118|10@1- (0.05,0) [0|1023] "" XXX

BO_ 949 RADAR_TRACK_3b5: 24 RADAR
 SG_ VALID : 25|2@0+ (1,0) [0|3] "" XXX
 SG_ VALID2 : 28|2@0+ (1,0) [0|3] "" XXX
 SG_ PROB : 30|10@1+ (1,0) [0|1023] "" XXX
 SG_ VALID_CNT : 47|8@0+ (1,0) [0|255] "" XXX
 SG_ NEW_SIGNAL_7 : 51|4@0+ (1,0) [0|15] "" XXX
 SG_ NEW_SIGNAL_6 : 55|4@0+ (1,0) [0|15] "" XXX
 SG_ NEW_SIGNAL_2 : 62|7@0- (1,0) [0|127] "" XXX
 SG_ LONG_DIST : 63|13@1+ (0.05,0) [0|8191] "" XXX
 SG_ LAT_DIST : 76|12@1- (0.05,0) [0|4095] "" XXX
 SG_ REL_SPEED : 88|14@1- (0.01,0) [0|16383] "" XXX
 SG_ IN_MYLANE : 103|2@0+ (1,0) [0|3] "" XXX
 SG_ LAT_SPEED : 104|13@1- (0.01,0) [0|8191] "" XXX
 SG_ REL_ACCEL : 118|10@1- (0.05,0) [0|1023] "" XXX

BO_ 950 RADAR_TRACK_3b6: 24 RADAR
 SG_ VALID : 25|2@0+ (1,0) [0|3] "" XXX
 SG_ VALID2 : 28|2@0+ (1,0) [0|3] "" XXX
 SG_ PROB : 30|10@1+ (1,0) [0|1023] "" XXX
 SG_ VALID_CNT : 47|8@0+ (1,0) [0|255] "" XXX
 SG_ NEW_SIGNAL_7 : 51|4@0+ (1,0) [0|15] "" XXX
 SG_ NEW_SIGNAL_6 : 55|4@0+ (1,0) [0|15] "" XXX
 SG_ NEW_SIGNAL_2 : 62|7@0- (1,0) [0|127] "" XXX
 SG_ LONG_DIST : 63|13@1+ (0.05,0) [0|8191] "" XXX
 SG_ LAT_DIST : 76|12@1- (0.05,0) [0|4095] "" XXX
 SG_ REL_SPEED : 88|14@1- (0.01,0) [0|16383] "" XXX
 SG_ IN_MYLANE : 103|2@0+ (1,0) [0|3] "" XXX
 SG_ LAT_SPEED : 104|13@1- (0.01,0) [0|8191] "" XXX
 SG_ REL_ACCEL : 118|10@1- (0.05,0) [0|1023] "" XXX

BO_ 951 RADAR_TRACK_3b7: 24 RADAR
 SG_ VALID : 25|2@0+ (1,0) [0|3] "" XXX
 SG_ VALID2 : 28|2@0+ (1,0) [0|3] "" XXX
 SG_ PROB : 30|10@1+ (1,0) [0|1023] "" XXX
 SG_ VALID_CNT : 47|8@0+ (1,0) [0|255] "" XXX
 SG_ NEW_SIGNAL_7 : 51|4@0+ (1,0) [0|15] "" XXX
 SG_ NEW_SIGNAL_6 : 55|4@0+ (1,0) [0|15] "" XXX
 SG_ NEW_SIGNAL_2 : 62|7@0- (1,0) [0|127] "" XXX
 SG_ LONG_DIST : 63|13@1+ (0.05,0) [0|8191] "" XXX
 SG_ LAT_DIST : 76|12@1- (0.05,0) [0|4095] "" XXX
 SG_ REL_SPEED : 88|14@1- (0.01,0) [0|16383] "" XXX
 SG_ IN_MYLANE : 103|2@0+ (1,0) [0|3] "" XXX
 SG_ LAT_SPEED : 104|13@1- (0.01,0) [0|8191] "" XXX
 SG_ REL_ACCEL : 118|10@1- (0.05,0) [0|1023] "" XXX

BO_ 952 RADAR_TRACK_3b8: 24 RADAR
 SG_ VALID : 25|2@0+ (1,0) [0|3] "" XXX
 SG_ VALID2 : 28|2@0+ (1,0) [0|3] "" XXX
 SG_ PROB : 30|10@1+ (1,0) [0|1023] "" XXX
 SG_ VALID_CNT : 47|8@0+ (1,0) [0|255] "" XXX
 SG_ NEW_SIGNAL_7 : 51|4@0+ (1,0) [0|15] "" XXX
 SG_ NEW_SIGNAL_6 : 55|4@0+ (1,0) [0|15] "" XXX
 SG_ NEW_SIGNAL_2 : 62|7@0- (1,0) [0|127] "" XXX
 SG_ LONG_DIST : 63|13@1+ (0.05,0) [0|8191] "" XXX
 SG_ LAT_DIST : 76|12@1- (0.05,0) [0|4095] "" XXX
 SG_ REL_SPEED : 88|14@1- (0.01,0) [0|16383] "" XXX
 SG_ IN_MYLANE : 103|2@0+ (1,0) [0|3] "" XXX
 SG_ LAT_SPEED : 104|13@1- (0.01,0) [0|8191] "" XXX
 SG_ REL_ACCEL : 118|10@1- (0.05,0) [0|1023] "" XXX

BO_ 953 RADAR_TRACK_3b9: 24 RADAR
 SG_ VALID : 25|2@0+ (1,0) [0|3] "" XXX
 SG_ VALID2 : 28|2@0+ (1,0) [0|3] "" XXX
 SG_ PROB : 30|10@1+ (1,0) [0|1023] "" XXX
 SG_ VALID_CNT : 47|8@0+ (1,0) [0|255] "" XXX
 SG_ NEW_SIGNAL_7 : 51|4@0+ (1,0) [0|15] "" XXX
 SG_ NEW_SIGNAL_6 : 55|4@0+ (1,0) [0|15] "" XXX
 SG_ NEW_SIGNAL_2 : 62|7@0- (1,0) [0|127] "" XXX
 SG_ LONG_DIST : 63|13@1+ (0.05,0) [0|8191] "" XXX
 SG_ LAT_DIST : 76|12@1- (0.05,0) [0|4095] "" XXX
 SG_ REL_SPEED : 88|14@1- (0.01,0) [0|16383] "" XXX
 SG_ IN_MYLANE : 103|2@0+ (1,0) [0|3] "" XXX
 SG_ LAT_SPEED : 104|13@1- (0.01,0) [0|8191] "" XXX
 SG_ REL_ACCEL : 118|10@1- (0.05,0) [0|1023] "" XXX

BO_ 954 RADAR_TRACK_3ba: 24 RADAR
 SG_ VALID : 25|2@0+ (1,0) [0|3] "" XXX
 SG_ VALID2 : 28|2@0+ (1,0) [0|3] "" XXX
 SG_ PROB : 30|10@1+ (1,0) [0|1023] "" XXX
 SG_ VALID_CNT : 47|8@0+ (1,0) [0|255] "" XXX
 SG_ NEW_SIGNAL_7 : 51|4@0+ (1,0) [0|15] "" XXX
 SG_ NEW_SIGNAL_6 : 55|4@0+ (1,0) [0|15] "" XXX
 SG_ NEW_SIGNAL_2 : 62|7@0- (1,0) [0|127] "" XXX
 SG_ LONG_DIST : 63|13@1+ (0.05,0) [0|8191] "" XXX
 SG_ LAT_DIST : 76|12@1- (0.05,0) [0|4095] "" XXX
 SG_ REL_SPEED : 88|14@1- (0.01,0) [0|16383] "" XXX
 SG_ IN_MYLANE : 103|2@0+ (1,0) [0|3] "" XXX
 SG_ LAT_SPEED : 104|13@1- (0.01,0) [0|8191] "" XXX
 SG_ REL_ACCEL : 118|10@1- (0.05,0) [0|1023] "" XXX

BO_ 955 RADAR_TRACK_3bb: 24 RADAR
 SG_ VALID : 25|2@0+ (1,0) [0|3] "" XXX
 SG_ VALID2 : 28|2@0+ (1,0) [0|3] "" XXX
 SG_ PROB : 30|10@1+ (1,0) [0|1023] "" XXX
 SG_ VALID_CNT : 47|8@0+ (1,0) [0|255] "" XXX
 SG_ NEW_SIGNAL_7 : 51|4@0+ (1,0) [0|15] "" XXX
 SG_ NEW_SIGNAL_6 : 55|4@0+ (1,0) [0|15] "" XXX
 SG_ NEW_SIGNAL_2 : 62|7@0- (1,0) [0|127] "" XXX
 SG_ LONG_DIST : 63|13@1+ (0.05,0) [0|8191] "" XXX
 SG_ LAT_DIST : 76|12@1- (0.05,0) [0|4095] "" XXX
 SG_ REL_SPEED : 88|14@1- (0.01,0) [0|16383] "" XXX
 SG_ IN_MYLANE : 103|2@0+ (1,0) [0|3] "" XXX
 SG_ LAT_SPEED : 104|13@1- (0.01,0) [0|8191] "" XXX
 SG_ REL_ACCEL : 118|10@1- (0.05,0) [0|1023] "" XXX

BO_ 956 RADAR_TRACK_3bc: 24 RADAR
 SG_ VALID : 25|2@0+ (1,0) [0|3] "" XXX
 SG_ VALID2 : 28|2@0+ (1,0) [0|3] "" XXX
 SG_ PROB : 30|10@1+ (1,0) [0|1023] "" XXX
 SG_ VALID_CNT : 47|8@0+ (1,0) [0|255] "" XXX
 SG_ NEW_SIGNAL_7 : 51|4@0+ (1,0) [0|15] "" XXX
 SG_ NEW_SIGNAL_6 : 55|4@0+ (1,0) [0|15] "" XXX
 SG_ NEW_SIGNAL_2 : 62|7@0- (1,0) [0|127] "" XXX
 SG_ LONG_DIST : 63|13@1+ (0.05,0) [0|8191] "" XXX
 SG_ LAT_DIST : 76|12@1- (0.05,0) [0|4095] "" XXX
 SG_ REL_SPEED : 88|14@1- (0.01,0) [0|16383] "" XXX
 SG_ IN_MYLANE : 103|2@0+ (1,0) [0|3] "" XXX
 SG_ LAT_SPEED : 104|13@1- (0.01,0) [0|8191] "" XXX
 SG_ REL_ACCEL : 118|10@1- (0.05,0) [0|1023] "" XXX

BO_ 957 RADAR_TRACK_3bd: 24 RADAR
 SG_ VALID : 25|2@0+ (1,0) [0|3] "" XXX
 SG_ VALID2 : 28|2@0+ (1,0) [0|3] "" XXX
 SG_ PROB : 30|10@1+ (1,0) [0|1023] "" XXX
 SG_ VALID_CNT : 47|8@0+ (1,0) [0|255] "" XXX
 SG_ NEW_SIGNAL_7 : 51|4@0+ (1,0) [0|15] "" XXX
 SG_ NEW_SIGNAL_6 : 55|4@0+ (1,0) [0|15] "" XXX
 SG_ NEW_SIGNAL_2 : 62|7@0- (1,0) [0|127] "" XXX
 SG_ LONG_DIST : 63|13@1+ (0.05,0) [0|8191] "" XXX
 SG_ LAT_DIST : 76|12@1- (0.05,0) [0|4095] "" XXX
 SG_ REL_SPEED : 88|14@1- (0.01,0) [0|16383] "" XXX
 SG_ IN_MYLANE : 103|2@0+ (1,0) [0|3] "" XXX
 SG_ LAT_SPEED : 104|13@1- (0.01,0) [0|8191] "" XXX
 SG_ REL_ACCEL : 118|10@1- (0.05,0) [0|1023] "" XXX

BO_ 958 RADAR_TRACK_3be: 24 RADAR
 SG_ VALID : 25|2@0+ (1,0) [0|3] "" XXX
 SG_ VALID2 : 28|2@0+ (1,0) [0|3] "" XXX
 SG_ PROB : 30|10@1+ (1,0) [0|1023] "" XXX
 SG_ VALID_CNT : 47|8@0+ (1,0) [0|255] "" XXX
 SG_ NEW_SIGNAL_7 : 51|4@0+ (1,0) [0|15] "" XXX
 SG_ NEW_SIGNAL_6 : 55|4@0+ (1,0) [0|15] "" XXX
 SG_ NEW_SIGNAL_2 : 62|7@0- (1,0) [0|127] "" XXX
 SG_ LONG_DIST : 63|13@1+ (0.05,0) [0|8191] "" XXX
 SG_ LAT_DIST : 76|12@1- (0.05,0) [0|4095] "" XXX
 SG_ REL_SPEED : 88|14@1- (0.01,0) [0|16383] "" XXX
 SG_ IN_MYLANE : 103|2@0+ (1,0) [0|3] "" XXX
 SG_ LAT_SPEED : 104|13@1- (0.01,0) [0|8191] "" XXX
 SG_ REL_ACCEL : 118|10@1- (0.05,0) [0|1023] "" XXX

BO_ 959 RADAR_TRACK_3bf: 24 RADAR
 SG_ VALID : 25|2@0+ (1,0) [0|3] "" XXX
 SG_ VALID2 : 28|2@0+ (1,0) [0|3] "" XXX
 SG_ PROB : 30|10@1+ (1,0) [0|1023] "" XXX
 SG_ VALID_CNT : 47|8@0+ (1,0) [0|255] "" XXX
 SG_ NEW_SIGNAL_7 : 51|4@0+ (1,0) [0|15] "" XXX
 SG_ NEW_SIGNAL_6 : 55|4@0+ (1,0) [0|15] "" XXX
 SG_ NEW_SIGNAL_2 : 62|7@0- (1,0) [0|127] "" XXX
 SG_ LONG_DIST : 63|13@1+ (0.05,0) [0|8191] "" XXX
 SG_ LAT_DIST : 76|12@1- (0.05,0) [0|4095] "" XXX
 SG_ REL_SPEED : 88|14@1- (0.01,0) [0|16383] "" XXX
 SG_ IN_MYLANE : 103|2@0+ (1,0) [0|3] "" XXX
 SG_ LAT_SPEED : 104|13@1- (0.01,0) [0|8191] "" XXX
 SG_ REL_ACCEL : 118|10@1- (0.05,0) [0|1023] "" XXX

BO_ 960 RADAR_TRACK_3c0: 24 RADAR
 SG_ VALID : 25|2@0+ (1,0) [0|3] "" XXX
 SG_ VALID2 : 28|2@0+ (1,0) [0|3] "" XXX
 SG_ PROB : 30|10@1+ (1,0) [0|1023] "" XXX
 SG_ VALID_CNT : 47|8@0+ (1,0) [0|255] "" XXX
 SG_ NEW_SIGNAL_7 : 51|4@0+ (1,0) [0|15] "" XXX
 SG_ NEW_SIGNAL_6 : 55|4@0+ (1,0) [0|15] "" XXX
 SG_ NEW_SIGNAL_2 : 62|7@0- (1,0) [0|127] "" XXX
 SG_ LONG_DIST : 63|13@1+ (0.05,0) [0|8191] "" XXX
 SG_ LAT_DIST : 76|12@1- (0.05,0) [0|4095] "" XXX
 SG_ REL_SPEED : 88|14@1- (0.01,0) [0|16383] "" XXX
 SG_ IN_MYLANE : 103|2@0+ (1,0) [0|3] "" XXX
 SG_ LAT_SPEED : 104|13@1- (0.01,0) [0|8191] "" XXX
 SG_ REL_ACCEL : 118|10@1- (0.05,0) [0|1023] "" XXX

BO_ 961 RADAR_TRACK_3c1: 24 RADAR
 SG_ VALID : 25|2@0+ (1,0) [0|3] "" XXX
 SG_ VALID2 : 28|2@0+ (1,0) [0|3] "" XXX
 SG_ PROB : 30|10@1+ (1,0) [0|1023] "" XXX
 SG_ VALID_CNT : 47|8@0+ (1,0) [0|255] "" XXX
 SG_ NEW_SIGNAL_7 : 51|4@0+ (1,0) [0|15] "" XXX
 SG_ NEW_SIGNAL_6 : 55|4@0+ (1,0) [0|15] "" XXX
 SG_ NEW_SIGNAL_2 : 62|7@0- (1,0) [0|127] "" XXX
 SG_ LONG_DIST : 63|13@1+ (0.05,0) [0|8191] "" XXX
 SG_ LAT_DIST : 76|12@1- (0.05,0) [0|4095] "" XXX
 SG_ REL_SPEED : 88|14@1- (0.01,0) [0|16383] "" XXX
 SG_ IN_MYLANE : 103|2@0+ (1,0) [0|3] "" XXX
 SG_ LAT_SPEED : 104|13@1- (0.01,0) [0|8191] "" XXX
 SG_ REL_ACCEL : 118|10@1- (0.05,0) [0|1023] "" XXX

BO_ 962 RADAR_TRACK_3c2: 24 RADAR
 SG_ VALID : 25|2@0+ (1,0) [0|3] "" XXX
 SG_ VALID2 : 28|2@0+ (1,0) [0|3] "" XXX
 SG_ PROB : 30|10@1+ (1,0) [0|1023] "" XXX
 SG_ VALID_CNT : 47|8@0+ (1,0) [0|255] "" XXX
 SG_ NEW_SIGNAL_7 : 51|4@0+ (1,0) [0|15] "" XXX
 SG_ NEW_SIGNAL_6 : 55|4@0+ (1,0) [0|15] "" XXX
 SG_ NEW_SIGNAL_2 : 62|7@0- (1,0) [0|127] "" XXX
 SG_ LONG_DIST : 63|13@1+ (0.05,0) [0|8191] "" XXX
 SG_ LAT_DIST : 76|12@1- (0.05,0) [0|4095] "" XXX
 SG_ REL_SPEED : 88|14@1- (0.01,0) [0|16383] "" XXX
 SG_ IN_MYLANE : 103|2@0+ (1,0) [0|3] "" XXX
 SG_ LAT_SPEED : 104|13@1- (0.01,0) [0|8191] "" XXX
 SG_ REL_ACCEL : 118|10@1- (0.05,0) [0|1023] "" XXX

BO_ 963 RADAR_TRACK_3c3: 24 RADAR
 SG_ VALID : 25|2@0+ (1,0) [0|3] "" XXX
 SG_ VALID2 : 28|2@0+ (1,0) [0|3] "" XXX
 SG_ PROB : 30|10@1+ (1,0) [0|1023] "" XXX
 SG_ VALID_CNT : 47|8@0+ (1,0) [0|255] "" XXX
 SG_ NEW_SIGNAL_7 : 51|4@0+ (1,0) [0|15] "" XXX
 SG_ NEW_SIGNAL_6 : 55|4@0+ (1,0) [0|15] "" XXX
 SG_ NEW_SIGNAL_2 : 62|7@0- (1,0) [0|127] "" XXX
 SG_ LONG_DIST : 63|13@1+ (0.05,0) [0|8191] "" XXX
 SG_ LAT_DIST : 76|12@1- (0.05,0) [0|4095] "" XXX
 SG_ REL_SPEED : 88|14@1- (0.01,0) [0|16383] "" XXX
 SG_ IN_MYLANE : 103|2@0+ (1,0) [0|3] "" XXX
 SG_ LAT_SPEED : 104|13@1- (0.01,0) [0|8191] "" XXX
 SG_ REL_ACCEL : 118|10@1- (0.05,0) [0|1023] "" XXX

BO_ 964 RADAR_TRACK_3c4: 24 RADAR
 SG_ VALID : 25|2@0+ (1,0) [0|3] "" XXX
 SG_ VALID2 : 28|2@0+ (1,0) [0|3] "" XXX
 SG_ PROB : 30|10@1+ (1,0) [0|1023] "" XXX
 SG_ VALID_CNT : 47|8@0+ (1,0) [0|255] "" XXX
 SG_ NEW_SIGNAL_7 : 51|4@0+ (1,0) [0|15] "" XXX
 SG_ NEW_SIGNAL_6 : 55|4@0+ (1,0) [0|15] "" XXX
 SG_ NEW_SIGNAL_2 : 62|7@0- (1,0) [0|127] "" XXX
 SG_ LONG_DIST : 63|13@1+ (0.05,0) [0|8191] "" XXX
 SG_ LAT_DIST : 76|12@1- (0.05,0) [0|4095] "" XXX
 SG_ REL_SPEED : 88|14@1- (0.01,0) [0|16383] "" XXX
 SG_ IN_MYLANE : 103|2@0+ (1,0) [0|3] "" XXX
 SG_ LAT_SPEED : 104|13@1- (0.01,0) [0|8191] "" XXX
 SG_ REL_ACCEL : 118|10@1- (0.05,0) [0|1023] "" XXX

BO_ 1024 RADAR_TRACK_400: 24 RADAR
 SG_ OBJECT_ID : 24|7@1+ (1,0) [0|127] "" XXX
 SG_ OBJECT_LENGTH : 41|7@1+ (0.1,0) [0|12.7] "m" XXX
 SG_ LONG_DIST : 64|11@1+ (0.1,0) [0|204.7] "m" XXX
 SG_ LAT_DIST : 75|12@1- (0.05,0) [-102.4|102.35] "m" XXX
 SG_ REL_SPEED : 87|11@1- (0.1,0) [-102.4|102.3] "m/s" XXX

BO_ 1025 RADAR_TRACK_401: 24 RADAR
 SG_ OBJECT_ID : 24|7@1+ (1,0) [0|127] "" XXX
 SG_ OBJECT_LENGTH : 41|7@1+ (0.1,0) [0|12.7] "m" XXX
 SG_ LONG_DIST : 64|11@1+ (0.1,0) [0|204.7] "m" XXX
 SG_ LAT_DIST : 75|12@1- (0.05,0) [-102.4|102.35] "m" XXX
 SG_ REL_SPEED : 87|11@1- (0.1,0) [-102.4|102.3] "m/s" XXX

BO_ 1026 RADAR_TRACK_402: 24 RADAR
 SG_ OBJECT_ID : 24|7@1+ (1,0) [0|127] "" XXX
 SG_ OBJECT_LENGTH : 41|7@1+ (0.1,0) [0|12.7] "m" XXX
 SG_ LONG_DIST : 64|11@1+ (0.1,0) [0|204.7] "m" XXX
 SG_ LAT_DIST : 75|12@1- (0.05,0) [-102.4|102.35] "m" XXX
 SG_ REL_SPEED : 87|11@1- (0.1,0) [-102.4|102.3] "m/s" XXX

BO_ 1027 RADAR_TRACK_403: 24 RADAR
 SG_ OBJECT_ID : 24|7@1+ (1,0) [0|127] "" XXX
 SG_ OBJECT_LENGTH : 41|7@1+ (0.1,0) [0|12.7] "m" XXX
 SG_ LONG_DIST : 64|11@1+ (0.1,0) [0|204.7] "m" XXX
 SG_ LAT_DIST : 75|12@1- (0.05,0) [-102.4|102.35] "m" XXX
 SG_ REL_SPEED : 87|11@1- (0.1,0) [-102.4|102.3] "m/s" XXX

BO_ 1028 RADAR_TRACK_404: 24 RADAR
 SG_ OBJECT_ID : 24|7@1+ (1,0) [0|127] "" XXX
 SG_ OBJECT_LENGTH : 41|7@1+ (0.1,0) [0|12.7] "m" XXX
 SG_ LONG_DIST : 64|11@1+ (0.1,0) [0|204.7] "m" XXX
 SG_ LAT_DIST : 75|12@1- (0.05,0) [-102.4|102.35] "m" XXX
 SG_ REL_SPEED : 87|11@1- (0.1,0) [-102.4|102.3] "m/s" XXX

BO_ 1029 RADAR_TRACK_405: 24 RADAR
 SG_ OBJECT_ID : 24|7@1+ (1,0) [0|127] "" XXX
 SG_ OBJECT_LENGTH : 41|7@1+ (0.1,0) [0|12.7] "m" XXX
 SG_ LONG_DIST : 64|11@1+ (0.1,0) [0|204.7] "m" XXX
 SG_ LAT_DIST : 75|12@1- (0.05,0) [-102.4|102.35] "m" XXX
 SG_ REL_SPEED : 87|11@1- (0.1,0) [-102.4|102.3] "m/s" XXX

BO_ 1030 RADAR_TRACK_406: 24 RADAR
 SG_ OBJECT_ID : 24|7@1+ (1,0) [0|127] "" XXX
 SG_ OBJECT_LENGTH : 41|7@1+ (0.1,0) [0|12.7] "m" XXX
 SG_ LONG_DIST : 64|11@1+ (0.1,0) [0|204.7] "m" XXX
 SG_ LAT_DIST : 75|12@1- (0.05,0) [-102.4|102.35] "m" XXX
 SG_ REL_SPEED : 87|11@1- (0.1,0) [-102.4|102.3] "m/s" XXX

BO_ 1031 RADAR_TRACK_407: 24 RADAR
 SG_ OBJECT_ID : 24|7@1+ (1,0) [0|127] "" XXX
 SG_ OBJECT_LENGTH : 41|7@1+ (0.1,0) [0|12.7] "m" XXX
 SG_ LONG_DIST : 64|11@1+ (0.1,0) [0|204.7] "m" XXX
 SG_ LAT_DIST : 75|12@1- (0.05,0) [-102.4|102.35] "m" XXX
 SG_ REL_SPEED : 87|11@1- (0.1,0) [-102.4|102.3] "m/s" XXX

BO_ 1032 RADAR_TRACK_408: 24 RADAR
 SG_ OBJECT_ID : 24|7@1+ (1,0) [0|127] "" XXX
 SG_ OBJECT_LENGTH : 41|7@1+ (0.1,0) [0|12.7] "m" XXX
 SG_ LONG_DIST : 64|11@1+ (0.1,0) [0|204.7] "m" XXX
 SG_ LAT_DIST : 75|12@1- (0.05,0) [-102.4|102.35] "m" XXX
 SG_ REL_SPEED : 87|11@1- (0.1,0) [-102.4|102.3] "m/s" XXX

BO_ 1033 RADAR_TRACK_409: 24 RADAR
 SG_ OBJECT_ID : 24|7@1+ (1,0) [0|127] "" XXX
 SG_ OBJECT_LENGTH : 41|7@1+ (0.1,0) [0|12.7] "m" XXX
 SG_ LONG_DIST : 64|11@1+ (0.1,0) [0|204.7] "m" XXX
 SG_ LAT_DIST : 75|12@1- (0.05,0) [-102.4|102.35] "m" XXX
 SG_ REL_SPEED : 87|11@1- (0.1,0) [-102.4|102.3] "m/s" XXX

BO_ 1034 RADAR_TRACK_40a: 24 RADAR
 SG_ OBJECT_ID : 24|7@1+ (1,0) [0|127] "" XXX
 SG_ OBJECT_LENGTH : 41|7@1+ (0.1,0) [0|12.7] "m" XXX
 SG_ LONG_DIST : 64|11@1+ (0.1,0) [0|204.7] "m" XXX
 SG_ LAT_DIST : 75|12@1- (0.05,0) [-102.4|102.35] "m" XXX
 SG_ REL_SPEED : 87|11@1- (0.1,0) [-102.4|102.3] "m/s" XXX

BO_ 1035 RADAR_TRACK_40b: 24 RADAR
 SG_ OBJECT_ID : 24|7@1+ (1,0) [0|127] "" XXX
 SG_ OBJECT_LENGTH : 41|7@1+ (0.1,0) [0|12.7] "m" XXX
 SG_ LONG_DIST : 64|11@1+ (0.1,0) [0|204.7] "m" XXX
 SG_ LAT_DIST : 75|12@1- (0.05,0) [-102.4|102.35] "m" XXX
 SG_ REL_SPEED : 87|11@1- (0.1,0) [-102.4|102.3] "m/s" XXX

BO_ 1036 RADAR_TRACK_40c: 24 RADAR
 SG_ OBJECT_ID : 24|7@1+ (1,0) [0|127] "" XXX
 SG_ OBJECT_LENGTH : 41|7@1+ (0.1,0) [0|12.7] "m" XXX
 SG_ LONG_DIST : 64|11@1+ (0.1,0) [0|204.7] "m" XXX
 SG_ LAT_DIST : 75|12@1- (0.05,0) [-102.4|102.35] "m" XXX
 SG_ REL_SPEED : 87|11@1- (0.1,0) [-102.4|102.3] "m/s" XXX

BO_ 1037 RADAR_TRACK_40d: 24 RADAR
 SG_ OBJECT_ID : 24|7@1+ (1,0) [0|127] "" XXX
 SG_ OBJECT_LENGTH : 41|7@1+ (0.1,0) [0|12.7] "m" XXX
 SG_ LONG_DIST : 64|11@1+ (0.1,0) [0|204.7] "m" XXX
 SG_ LAT_DIST : 75|12@1- (0.05,0) [-102.4|102.35] "m" XXX
 SG_ REL_SPEED : 87|11@1- (0.1,0) [-102.4|102.3] "m/s" XXX

BO_ 1038 RADAR_TRACK_40e: 24 RADAR
 SG_ OBJECT_ID : 24|7@1+ (1,0) [0|127] "" XXX
 SG_ OBJECT_LENGTH : 41|7@1+ (0.1,0) [0|12.7] "m" XXX
 SG_ LONG_DIST : 64|11@1+ (0.1,0) [0|204.7] "m" XXX
 SG_ LAT_DIST : 75|12@1- (0.05,0) [-102.4|102.35] "m" XXX
 SG_ REL_SPEED : 87|11@1- (0.1,0) [-102.4|102.3] "m/s" XXX

BO_ 1039 RADAR_TRACK_40f: 24 RADAR
 SG_ OBJECT_ID : 24|7@1+ (1,0) [0|127] "" XXX
 SG_ OBJECT_LENGTH : 41|7@1+ (0.1,0) [0|12.7] "m" XXX
 SG_ LONG_DIST : 64|11@1+ (0.1,0) [0|204.7] "m" XXX
 SG_ LAT_DIST : 75|12@1- (0.05,0) [-102.4|102.35] "m" XXX
 SG_ REL_SPEED : 87|11@1- (0.1,0) [-102.4|102.3] "m/s" XXX

BO_ 1040 RADAR_TRACK_410: 24 RADAR
 SG_ OBJECT_ID : 24|7@1+ (1,0) [0|127] "" XXX
 SG_ OBJECT_LENGTH : 41|7@1+ (0.1,0) [0|12.7] "m" XXX
 SG_ LONG_DIST : 64|11@1+ (0.1,0) [0|204.7] "m" XXX
 SG_ LAT_DIST : 75|12@1- (0.05,0) [-102.4|102.35] "m" XXX
 SG_ REL_SPEED : 87|11@1- (0.1,0) [-102.4|102.3] "m/s" XXX

BO_ 1041 RADAR_TRACK_411: 24 RADAR
 SG_ OBJECT_ID : 24|7@1+ (1,0) [0|127] "" XXX
 SG_ OBJECT_LENGTH : 41|7@1+ (0.1,0) [0|12.7] "m" XXX
 SG_ LONG_DIST : 64|11@1+ (0.1,0) [0|204.7] "m" XXX
 SG_ LAT_DIST : 75|12@1- (0.05,0) [-102.4|102.35] "m" XXX
 SG_ REL_SPEED : 87|11@1- (0.1,0) [-102.4|102.3] "m/s" XXX

BO_ 1042 RADAR_TRACK_412: 24 RADAR
 SG_ OBJECT_ID : 24|7@1+ (1,0) [0|127] "" XXX
 SG_ OBJECT_LENGTH : 41|7@1+ (0.1,0) [0|12.7] "m" XXX
 SG_ LONG_DIST : 64|11@1+ (0.1,0) [0|204.7] "m" XXX
 SG_ LAT_DIST : 75|12@1- (0.05,0) [-102.4|102.35] "m" XXX
 SG_ REL_SPEED : 87|11@1- (0.1,0) [-102.4|102.3] "m/s" XXX

BO_ 1043 RADAR_TRACK_413: 24 RADAR
 SG_ OBJECT_ID : 24|7@1+ (1,0) [0|127] "" XXX
 SG_ OBJECT_LENGTH : 41|7@1+ (0.1,0) [0|12.7] "m" XXX
 SG_ LONG_DIST : 64|11@1+ (0.1,0) [0|204.7] "m" XXX
 SG_ LAT_DIST : 75|12@1- (0.05,0) [-102.4|102.35] "m" XXX
 SG_ REL_SPEED : 87|11@1- (0.1,0) [-102.4|102.3] "m/s" XXX

BO_ 1044 RADAR_TRACK_414: 24 RADAR
 SG_ OBJECT_ID : 24|7@1+ (1,0) [0|127] "" XXX
 SG_ OBJECT_LENGTH : 41|7@1+ (0.1,0) [0|12.7] "m" XXX
 SG_ LONG_DIST : 64|11@1+ (0.1,0) [0|204.7] "m" XXX
 SG_ LAT_DIST : 75|12@1- (0.05,0) [-102.4|102.35] "m" XXX
 SG_ REL_SPEED : 87|11@1- (0.1,0) [-102.4|102.3] "m/s" XXX

BO_ 1045 RADAR_TRACK_415: 24 RADAR
 SG_ OBJECT_ID : 24|7@1+ (1,0) [0|127] "" XXX
 SG_ OBJECT_LENGTH : 41|7@1+ (0.1,0) [0|12.7] "m" XXX
 SG_ LONG_DIST : 64|11@1+ (0.1,0) [0|204.7] "m" XXX
 SG_ LAT_DIST : 75|12@1- (0.05,0) [-102.4|102.35] "m" XXX
 SG_ REL_SPEED : 87|11@1- (0.1,0) [-102.4|102.3] "m/s" XXX

BO_ 1046 RADAR_TRACK_416: 24 RADAR
 SG_ OBJECT_ID : 24|7@1+ (1,0) [0|127] "" XXX
 SG_ OBJECT_LENGTH : 41|7@1+ (0.1,0) [0|12.7] "m" XXX
 SG_ LONG_DIST : 64|11@1+ (0.1,0) [0|204.7] "m" XXX
 SG_ LAT_DIST : 75|12@1- (0.05,0) [-102.4|102.35] "m" XXX
 SG_ REL_SPEED : 87|11@1- (0.1,0) [-102.4|102.3] "m/s" XXX

BO_ 1047 RADAR_TRACK_417: 24 RADAR
 SG_ OBJECT_ID : 24|7@1+ (1,0) [0|127] "" XXX
 SG_ OBJECT_LENGTH : 41|7@1+ (0.1,0) [0|12.7] "m" XXX
 SG_ LONG_DIST : 64|11@1+ (0.1,0) [0|204.7] "m" XXX
 SG_ LAT_DIST : 75|12@1- (0.05,0) [-102.4|102.35] "m" XXX
 SG_ REL_SPEED : 87|11@1- (0.1,0) [-102.4|102.3] "m/s" XXX

BO_ 1048 RADAR_TRACK_418: 24 RADAR
 SG_ OBJECT_ID : 24|7@1+ (1,0) [0|127] "" XXX
 SG_ OBJECT_LENGTH : 41|7@1+ (0.1,0) [0|12.7] "m" XXX
 SG_ LONG_DIST : 64|11@1+ (0.1,0) [0|204.7] "m" XXX
 SG_ LAT_DIST : 75|12@1- (0.05,0) [-102.4|102.35] "m" XXX
 SG_ REL_SPEED : 87|11@1- (0.1,0) [-102.4|102.3] "m/s" XXX

BO_ 1049 RADAR_TRACK_419: 24 RADAR
 SG_ OBJECT_ID : 24|7@1+ (1,0) [0|127] "" XXX
 SG_ OBJECT_LENGTH : 41|7@1+ (0.1,0) [0|12.7] "m" XXX
 SG_ LONG_DIST : 64|11@1+ (0.1,0) [0|204.7] "m" XXX
 SG_ LAT_DIST : 75|12@1- (0.05,0) [-102.4|102.35] "m" XXX
 SG_ REL_SPEED : 87|11@1- (0.1,0) [-102.4|102.3] "m/s" XXX

BO_ 1050 RADAR_TRACK_41a: 24 RADAR
 SG_ OBJECT_ID : 24|7@1+ (1,0) [0|127] "" XXX
 SG_ OBJECT_LENGTH : 41|7@1+ (0.1,0) [0|12.7] "m" XXX
 SG_ LONG_DIST : 64|11@1+ (0.1,0) [0|204.7] "m" XXX
 SG_ LAT_DIST : 75|12@1- (0.05,0) [-102.4|102.35] "m" XXX
 SG_ REL_SPEED : 87|11@1- (0.1,0) [-102.4|102.3] "m/s" XXX

BO_ 1051 RADAR_TRACK_41b: 24 RADAR
 SG_ OBJECT_ID : 24|7@1+ (1,0) [0|127] "" XXX
 SG_ OBJECT_LENGTH : 41|7@1+ (0.1,0) [0|12.7] "m" XXX
 SG_ LONG_DIST : 64|11@1+ (0.1,0) [0|204.7] "m" XXX
 SG_ LAT_DIST : 75|12@1- (0.05,0) [-102.4|102.35] "m" XXX
 SG_ REL_SPEED : 87|11@1- (0.1,0) [-102.4|102.3] "m/s" XXX

BO_ 1052 RADAR_TRACK_41c: 24 RADAR
 SG_ OBJECT_ID : 24|7@1+ (1,0) [0|127] "" XXX
 SG_ OBJECT_LENGTH : 41|7@1+ (0.1,0) [0|12.7] "m" XXX
 SG_ LONG_DIST : 64|11@1+ (0.1,0) [0|204.7] "m" XXX
 SG_ LAT_DIST : 75|12@1- (0.05,0) [-102.4|102.35] "m" XXX
 SG_ REL_SPEED : 87|11@1- (0.1,0) [-102.4|102.3] "m/s" XXX

BO_ 1053 RADAR_TRACK_41d: 24 RADAR
 SG_ OBJECT_ID : 24|7@1+ (1,0) [0|127] "" XXX
 SG_ OBJECT_LENGTH : 41|7@1+ (0.1,0) [0|12.7] "m" XXX
 SG_ LONG_DIST : 64|11@1+ (0.1,0) [0|204.7] "m" XXX
 SG_ LAT_DIST : 75|12@1- (0.05,0) [-102.4|102.35] "m" XXX
 SG_ REL_SPEED : 87|11@1- (0.1,0) [-102.4|102.3] "m/s" XXX
